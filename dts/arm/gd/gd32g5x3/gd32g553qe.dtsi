/*
 * Copyright (c) 2026 GigaDevice Semiconductor Inc.
 *
 * SPDX-License-Identifier: Apache-2.0
 */

#include <mem.h>
#include <freq.h>
#include <gd/gd32g5x3/gd32g5x3.dtsi>

&cpu0 {
	/* Must match the PLL setting in the HAL system_gd32g5x3.c (216 MHz). */
	clock-frequency = <DT_FREQ_M(216)>;
};

&flash0 {
	reg = <0x08000000 DT_SIZE_K(512)>;
};
