## boards/gd/gd32h75ey_eval/board.yml
```yaml
board:
  name: gd32h75ey_eval
  full_name: GD32H75EY-EVAL
  vendor: gd
  socs:
    - name: gd32h75e
```

## boards/gd/gd32h75ey_eval/gd32h75ey_eval_defconfig
```kconfig
# Copyright (c) 2026 GigaDevice Semiconductor Inc.
# SPDX-License-Identifier: Apache-2.0

CONFIG_BOARD_GD32H75EY_EVAL=y

CONFIG_ARM_MPU=y
CONFIG_HW_STACK_PROTECTION=y

CONFIG_CONSOLE=y
CONFIG_UART_CONSOLE=y
CONFIG_STDOUT_CONSOLE=y
CONFIG_SERIAL=y

CONFIG_GPIO=y
CONFIG_PWM=y

# D-cache disabled for initial bring-up to rule out cache coherency issues
# with DMA. Cortex-M7 arch enables DCACHE by default, must explicitly disable.
# Re-enable after DMA is confirmed working with proper cache management.
CONFIG_DCACHE=n
```

## boards/gd/gd32m531r_eval/board.yml
```yaml
board:
  name: gd32m531r_eval
  full_name: GD32M531R-EVAL
  vendor: gd
  socs:
    - name: gd32m531
```

## drivers/adc/Kconfig.gd32
```kconfig
# ADC configuration options

# Copyright (c) 2021 BrainCo Inc.
# Copyright (c) 2026 GigaDevice Semiconductor Inc.
# SPDX-License-Identifier: Apache-2.0

config ADC_GD32
	bool "GD32 ADC driver"
	default y
	depends on DT_HAS_GD_GD32_ADC_ENABLED
	select PINCTRL
	select USE_GD32_TRIGSEL if SOC_SERIES_GD32H7XX || SOC_SERIES_GD32H75E
	select USE_GD32_ADC
	help
	  Enable GigaDevice GD32 ADC driver

config ADC_GD32_DMA
	bool "GD32 ADC DMA support"
	select DMA
	help
	  Use DMA to transfer ADC regular conversion results for ADC nodes
	  that define a "rx" dma channel in their device tree node.
```

## drivers/can/Kconfig.gd32
```kconfig
# GD32 CAN configuration options

# Copyright (c) 2026, GigaDevice Semiconductor Inc.
# SPDX-License-Identifier: Apache-2.0

config CAN_GD32
	bool "GD32 CAN Driver"
	default y
	depends on DT_HAS_GD_GD32_CAN_ENABLED
	select PINCTRL
	help
	  Enable GD32 CAN Driver.

config CAN_MAX_STD_ID_FILTER
	int "Maximum number of std ID filters"
	default 14
	range 0 28
	help
	  Defines the maximum number of filters with standard ID (11-bit)
	  that can be added by the application.

	  One standard ID filter with mask occupies 1/2 of the 14 available
	  filter banks.

	  The following equation determines the maximum total number of
	  filters:

	    CAN_MAX_STD_ID_FILTER + CAN_MAX_EXT_ID_FILTER * 2 <= 28

config CAN_MAX_EXT_ID_FILTER
	int "Maximum number of ext ID filters"
	default 7
	range 0 14
	help
	  Defines the maximum number of filters with extended ID (29-bit)
	  that can be added by the application.

	  One extended ID filter with mask occupies 1 of the 14 available
	  filter banks.

	  The following equation determines the maximum total number of
	  filters:

	    CAN_MAX_STD_ID_FILTER + CAN_MAX_EXT_ID_FILTER * 2 <= 28
```

## drivers/display/Kconfig.gd32_tli
```kconfig
# Copyright (c) 2025 GigaDevice Semiconductor Inc.
# SPDX-License-Identifier: Apache-2.0

menuconfig GD32_TLI
	bool "GD32 TLI (TFT-LCD Interface) display driver"
	default y
	depends on DT_HAS_GD_GD32_TLI_ENABLED
	select USE_GD32_RCU
	select USE_GD32_TLI
	help
	  Enable driver for GD32 TLI (TFT-LCD Interface) display controller.
	  This driver supports multiple pixel formats and provides framebuffer
	  access for display operations.

if GD32_TLI

choice GD32_TLI_PIXEL_FORMAT
	prompt "Color pixel format"
	default GD32_TLI_RGB565
	help
	  Specify the color pixel format for the GD32 TLI display controller.
	  This determines the framebuffer size at compile time.

config GD32_TLI_ARGB8888
	bool "ARGB8888"
	help
	  One pixel consists of 8-bit alpha, 8-bit red, 8-bit green and 8-bit blue.
	  (4 bytes per pixel, TLI PPF = 000)
	  Note: Requires ~512KB RAM for 480x272 display.

config GD32_TLI_RGB888
	bool "RGB888"
	help
	  One pixel consists of 8-bit red, 8-bit green and 8-bit blue.
	  (3 bytes per pixel, TLI PPF = 001)
	  Note: Requires ~384KB RAM for 480x272 display.

config GD32_TLI_RGB565
	bool "RGB565"
	help
	  One pixel consists of 5-bit red, 6-bit green and 5-bit blue.
	  (2 bytes per pixel, TLI PPF = 010)
	  Note: Requires ~256KB RAM for 480x272 display.

endchoice

config GD32_TLI_FB_NUM
	int "Frame buffer number"
	default 1
	range 1 2
	help
	  GD32 TLI frame buffer number configuration:
	    - 1: Single frame buffer (default)
	    - 2: Double frame buffer for tear-free rendering

endif # GD32_TLI
```

## drivers/dma/Kconfig.gd32
```kconfig
# Copyright (c) 2022 Tokita, Hiroshi <tokita.hiroshi@gmail.com>
# SPDX-License-Identifier: Apache-2.0

config DMA_GD32
	bool "Gigadevice GD32 DMA driver"
	default y
	depends on DT_HAS_GD_GD32_DMA_ENABLED || DT_HAS_GD_GD32_DMA_V1_ENABLED
	select USE_GD32_DMA
	help
	  DMA driver for GigaDevice GD32 series MCUs.

config DMAMUX_GD32
	bool "GigaDevice GD32 DMAMUX driver"
	default y
	depends on DT_HAS_GD_GD32_DMAMUX_ENABLED
	depends on DMA_GD32
	help
	  DMAMUX driver for GigaDevice GD32 series MCUs with DMA request
	  multiplexer (e.g., GD32F50x). The DMAMUX routes peripheral DMA
	  requests to DMA channels.

config DMAMUX_GD32_INIT_PRIORITY
	int "GD32 DMAMUX init priority"
	depends on DMAMUX_GD32
	default 41
	help
	  DMAMUX driver device must be initialized after the DMA driver.
	  Default 41 is higher than CONFIG_DMA_INIT_PRIORITY (default 40).
```

## drivers/ethernet/Kconfig.gd32
```kconfig
# Copyright (c) 2026, GigaDevice Semiconductor Inc.
# SPDX-License-Identifier: Apache-2.0

menuconfig ETH_GD32
	bool "GD32 Ethernet driver"
	default y
	depends on DT_HAS_GD_GD32_ETHERNET_ENABLED
	select USE_GD32_ENET
	select USE_GD32_SYSCFG
	select USE_GD32_RCU
	select PINCTRL
	select MDIO
	select HWINFO
	select CRC
	select NET_CHECKSUM_OFFLOAD_SUPPORTED if NET_L2_ETHERNET
	help
	  Enable GigaDevice GD32 Ethernet MAC driver.

if ETH_GD32

config ETH_GD32_RX_THREAD_STACK_SIZE
	int "RX thread stack size"
	default 1500
	help
	  Stack size of the thread that processes received Ethernet frames.

config ETH_GD32_RX_THREAD_PRIO
	int "RX thread priority"
	default 2
	help
	  Priority of the RX thread that processes received Ethernet frames.

config ETH_GD32_HW_CHECKSUM
	bool "Use TX and RX hardware checksum"
	depends on NET_CHECKSUM_OFFLOAD
	help
	  Enable hardware checksum offload in the GD32 ENET MAC/DMA to
	  reduce CPU load. When disabled (default), the network stack
	  computes checksums in software.

endif # ETH_GD32
```

## drivers/i2c/Kconfig.gd32
```kconfig
# Copyright (c) 2021 BrainCo Inc.
# Copyright (c) 2025 GigaDevice Semiconductor Inc.
# SPDX-License-Identifier: Apache-2.0

config I2C_GD32
	bool "GigaDevice GD32 I2C driver"
	default y
	depends on DT_HAS_GD_GD32_I2C_ENABLED || \
		   DT_HAS_GD_GD32_I2C_V2_ENABLED || \
		   DT_HAS_GD_GD32_I2C_V3_ENABLED
	select PINCTRL
	select USE_GD32_I2C
	help
	  Enable I2C support on the GD32 SoCs

config USE_GD32_I2C_V1
	bool "I2C driver version 1"
	default y
	depends on DT_HAS_GD_GD32_I2C_ENABLED
	select I2C_GD32_I2C_V1
	help
		Driver variant matching `gd,gd32-i2c` compatible.
		This is the original driver implementation for GD32F4XX and other earlier series.

config USE_GD32_I2C_V2
	bool "I2C driver version 2"
	default y
	depends on DT_HAS_GD_GD32_I2C_V2_ENABLED
	select I2C_GD32_I2C_V2
	help
		Driver variant matching `gd,gd32-i2c-v2` compatible.
		This version includes enhanced features and optimizations for GD32H7XX and newer series.

config USE_GD32_I2C_V3
	bool "I2C driver version 3"
	default y
	depends on DT_HAS_GD_GD32_I2C_V3_ENABLED
	select I2C_GD32_I2C_V3
	help
		Driver variant matching `gd,gd32-i2c-v3` compatible.
		This is the latest version with full feature support for GD32F527 series.

config I2C_GD32_I2C_V1
	bool
	help
		Internal symbol for I2C driver version 1.

config I2C_GD32_I2C_V2
	bool
	help
		Internal symbol for I2C driver version 2.

config I2C_GD32_I2C_V3
	bool
	help
		Internal symbol for I2C driver version 3.

config I2C_GD32_DMA
	bool "GD32 I2C DMA support"
	depends on I2C_GD32 && DMA
	help
	  Enable DMA support for GD32 I2C controllers.
	  This can significantly improve performance for large transfers
	  by offloading data movement from the CPU to the DMA controller.

if I2C_GD32_DMA

config I2C_GD32_DMA_THRESHOLD
	int "DMA transfer threshold"
	default 16
	range 4 255
	help
	  Minimum transfer size (in bytes) to use DMA instead of PIO mode.
	  Transfers smaller than this threshold will use PIO mode.
	  Larger values reduce DMA setup overhead for small transfers.
	  Default of 16 bytes provides good balance for most applications.

config I2C_GD32_DMA_TIMEOUT
	int "DMA transfer timeout (ms)"
	default 1000
	range 100 10000
	help
	  Timeout in milliseconds for DMA transfers.
	  If a DMA transfer does not complete within this time,
	  it will be considered failed.

endif # I2C_GD32_DMA
```

## drivers/mdio/Kconfig.gd32
```kconfig
# GD32 Ethernet MDIO controller configuration options

# Copyright (c) 2026, GigaDevice Semiconductor Inc.
# SPDX-License-Identifier: Apache-2.0

config MDIO_GD32_ENET
	bool "GD32 Ethernet MDIO controller driver"
	default y
	depends on DT_HAS_GD_GD32_ENET_MDIO_ENABLED
	depends on ETH_GD32
	select PINCTRL
	help
	  Enable MDIO support embedded in the GD32 Ethernet MAC registers
	  (ENET_MAC_PHY_CTL/ENET_MAC_PHY_DATA).
```

## drivers/pwm/Kconfig.gd32
```kconfig
# Copyright (c) 2021 Teslabs Engineering S.L.
# Copyright (c) 2026 GigaDevice Semiconductor Inc.
# SPDX-License-Identifier: Apache-2.0

config PWM_GD32
	bool "GigaDevice GD32 PWM driver"
	default y
	depends on DT_HAS_GD_GD32_PWM_ENABLED
	select PINCTRL
	select USE_GD32_TIMER
	help
	  Enable the GigaDevice GD32 PWM driver.
```

## drivers/serial/Kconfig.gd32
```kconfig
# Copyright (c) 2021 ATL Electronics
# SPDX-License-Identifier: Apache-2.0

config USART_GD32
	bool "GD32 serial driver"
	default y
	depends on DT_HAS_GD_GD32_USART_ENABLED
	select PINCTRL
	select SERIAL_HAS_DRIVER
	select SERIAL_SUPPORT_INTERRUPT
	select SERIAL_SUPPORT_ASYNC
	select DMA if UART_ASYNC_API
	select USE_GD32_USART
	help
	  This option enables the USART driver for GD32 SoC family.
```

## dts/bindings/adc/gd,gd32-adc-trigsel.yaml
```yaml
# Copyright (c) 2026 GigaDevice Semiconductor Inc.
# SPDX-License-Identifier: Apache-2.0

description: GigaDevice GD32 ADC with TRIGSEL

compatible: "gd,gd32-adc-trigsel"

include:
  - name: gd,gd32-adc.yaml

properties:
  trigger-select:
    required: true
```

## dts/bindings/adc/gd,gd32-adc.yaml
```yaml
# Copyright (c) 2022 BrainCo Inc.
# Copyright (c) 2026 GigaDevice Semiconductor Inc.
# SPDX-License-Identifier: Apache-2.0

description: GigaDevice GD32 ADC

# gd32 adc irq have some special cases as below:
#   1. adc number no larger than 3.
#   2. adc0 and adc1 share the same irq number.
#   3. For gd32f4xx, adc2 share the same irq number with adc0 and adc1.
#
# To cover this cases, adc_gd32 driver use node-label 'adc0', 'adc1' and
# 'adc2' to handle gd32 adc irq config directly.
#
# Sorry for the restriction, But new added gd32 adc node-label must be 'adc0',
# 'adc1' and 'adc2'.

compatible: "gd,gd32-adc"

include: [adc-controller.yaml, reset-device.yaml, pinctrl-device.yaml]

properties:
  reg:
    required: true

  resets:
    required: true

  clocks:
    required: true

  rcu-clock-source:
    type: int
    description: |
      Some GD32 ADC have additional clock source, like IRC14M or IRC28M.
      This property used to select the clock and related prescaler, valid
      values defined at 'dts-bindings/adc/gd32xxx.h' headers.

  channels:
    type: int
    description: Number of external channels
    required: true

  interrupts:
    required: true

  "#io-channel-cells":
    const: 1

  pinctrl-0:
    required: true

  pinctrl-names:
    required: true

  trigger-select:
    type: int
    default: 0
    description: |
      Trigger input source select.

      If not specified, defaults to software trigger (0).

      Example values:
        * TRIGSEL_INPUT_TIMER0_CH0   - 0x13
        * TRIGSEL_INPUT_TIMER0_CH1   - 0x14
        * TRIGSEL_INPUT_TIMER0_CH2   - 0x15
        * TRIGSEL_INPUT_TIMER0_CH3   - 0x16
        * TRIGSEL_INPUT_TIMER0_MCH0  - 0x17
        * TRIGSEL_INPUT_TIMER0_MCH1  - 0x18
        * TRIGSEL_INPUT_TIMER0_MCH2  - 0x19
        * TRIGSEL_INPUT_TIMER0_MCH3  - 0x1A
        * TRIGSEL_INPUT_TIMER1_CH0   - 0x26
        * TRIGSEL_INPUT_TIMER1_CH1   - 0x27
        * TRIGSEL_INPUT_TIMER1_CH2   - 0x28
        * TRIGSEL_INPUT_TIMER1_CH3   - 0x29
        * TRIGSEL_INPUT_TIMER2_CH0   - 0x2C
        * TRIGSEL_INPUT_TIMER2_CH1   - 0x2D
        * TRIGSEL_INPUT_TIMER2_CH2   - 0x2E
        * TRIGSEL_INPUT_TIMER2_CH3   - 0x2F
        * TRIGSEL_INPUT_TIMER3_CH0   - 0x32
        * TRIGSEL_INPUT_TIMER3_CH1   - 0x33
        * TRIGSEL_INPUT_TIMER3_CH2   - 0x34
        * TRIGSEL_INPUT_TIMER3_CH3   - 0x35
        * TRIGSEL_INPUT_TIMER4_CH0   - 0x38
        * TRIGSEL_INPUT_TIMER4_CH1   - 0x39
        * TRIGSEL_INPUT_TIMER4_CH2   - 0x3A
        * TRIGSEL_INPUT_TIMER4_CH3   - 0x3B

io-channel-cells:
  - input
```

## dts/bindings/can/gd,gd32-can.yaml
```yaml
# Copyright (c) 2026, GigaDevice Semiconductor Inc.
# SPDX-License-Identifier: Apache-2.0

description: GD32 CAN controller

compatible: "gd,gd32-can"

include: [can-fd-controller.yaml, reset-device.yaml, pinctrl-device.yaml]

properties:
  reg:
    required: true

  interrupts:
    required: true

  clocks:
    required: true

  pinctrl-0:
    required: true

  pinctrl-names:
    required: true

  master-can-reg:
    type: int
    description: master can reg when different from current instance

  sjw:
    type: int
    description: Synchronization jump width in time quanta (1-4)

  sjw-data:
    type: int
    description: Synchronization jump width for data phase in time quanta (CAN-FD)
```

## dts/bindings/counter/gd,gd32-timer.yaml
```yaml
# Copyright (c) 2021 Teslabs Engineering S.L.
# Copyright (c) 2026 GigaDevice Semiconductor Inc.
# SPDX-License-Identifier: Apache-2.0

description: GigaDevice GD32 timer

compatible: "gd,gd32-timer"

include: [reset-device.yaml, base.yaml]

properties:
  reg:
    required: true

  clocks:
    required: true

  resets:
    required: true

  channels:
    type: int
    required: true
    description: Number of timer channels.

  prescaler:
    type: int
    default: 0
    description: Timer prescaler. Defaults to 0 (SoC default).

  is-32bit:
    type: boolean
    description: Indicates if timer has a 32-bit counter.

  is-advanced:
    type: boolean
    description: |
      Indicates if timer has advanced features. Such features include break
      inputs, dead-time insertion, etc.

  alignedmode:
    type: int
    default: 0 # TIMER_COUNTER_EDGE- reset state
    description: |
      Sets timer counter mode.
      * TIMER_COUNTER_EDGE         - value:0x00; edge-aligned mode.
      * TIMER_COUNTER_CENTER_DOWN  - value:0x20; center-aligned and counting down assert mode.
      * TIMER_COUNTER_CENTER_UP    - value:0x40; center-aligned and counting up assert mode.
      * TIMER_COUNTER_CENTER_BOTH  - value:0x60; center-aligned and counting up/down assert mode.

  counterdirection:
    type: int
    default: 0 # TIMER_COUNTER_UP - reset state
    description: |
      Sets timer counter mode.
      * TIMER_COUNTER_UP                      -value:0x00; counter up direction.
      * TIMER_COUNTER_DOWN                    -value:0x10; counter down direction.

  deadtime:
    type: int
    default: 0 #  reset state
    description: Sets the deadtime of channels. The value is from 0 to 255.
                 Please refer to the product manual for more details.
```
