/*
 * Copyright (c) 2026 GigaDevice Semiconductor Inc.
 *
 * SPDX-License-Identifier: Apache-2.0
 */

&flash0 {
	partitions {
		compatible = "fixed-partitions";
		#address-cells = <1>;
		#size-cells = <1>;

		/* 64KB storage partition at the end of the 3840KB on-chip flash. */
		storage_partition: partition@3b0000 {
			label = "storage";
			reg = <0x003b0000 DT_SIZE_K(64)>;
		};
	};
};
