## tests/drivers/i2c/i2c_at24/boards/gd32m531r_eval.conf
```kconfig
# Copyright (c) 2026 GigaDevice Semiconductor Inc.
# SPDX-License-Identifier: Apache-2.0

CONFIG_LOG=y
CONFIG_SPI=y
CONFIG_DMA=y
CONFIG_UART_ASYNC_API=y
CONFIG_DEVICE_DEINIT_SUPPORT=y
CONFIG_I2C_GD32_DMA=y
```

## tests/drivers/uart/uart_async_api/boards/gd32h759i_eval.conf
```kconfig
# Copyright (c) 2026 GigaDevice Semiconductor Inc.
# SPDX-License-Identifier: Apache-2.0

# GD32H759 has Cortex-M7 with D-Cache enabled by default.
# Use the DT-defined NOCACHE memory region to ensure DMA buffers are
# placed in non-cacheable SRAM so DMA and CPU observe a coherent view.

CONFIG_DT_DEFINED_NOCACHE=y
CONFIG_DT_DEFINED_NOCACHE_NAME="RAM_NOCACHE"
CONFIG_CACHE_MANAGEMENT=y

CONFIG_TEST_USERSPACE=n
CONFIG_USERSPACE=n
```
