/*
 * Copyright (c) 2026 GigaDevice Semiconductor Inc.
 *
 * SPDX-License-Identifier: Apache-2.0
 */

/ {
	resources {
		compatible = "test-gpio-basic-api";
		/* Bridge PC6 (out) to PC7 (in) for 2-pin GPIO loopback test.
		 * PC6/PC7 are DCI D0/D1; unplug the camera module / jumper on
		 * that header before bridging.
		 */
		out-gpios = <&gpioc 6 GPIO_PULL_UP>;
		in-gpios = <&gpioc 7 GPIO_PULL_UP>;
	};
};

&gpioc {
	status = "okay";
};
