/*
 * Copyright (c) 2025 GigaDevice Semiconductor Inc.
 *
 * SPDX-License-Identifier: Apache-2.0
 */

#include <mem.h>
#include <freq.h>
#include <gd/gd32f50x/gd32f50x.dtsi>

&cpu0 {
	clock-frequency = <DT_FREQ_M(252)>;
};

&flash0 {
	reg = <0x08000000 DT_SIZE_K(1024)>;
};

&sram0 {
	reg = <0x20000000 DT_SIZE_K(128)>;
};
