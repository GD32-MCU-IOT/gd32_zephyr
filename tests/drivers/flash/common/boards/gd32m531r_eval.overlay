/*
 * Copyright (c) 2026 GigaDevice Semiconductor Inc.
 *
 * SPDX-License-Identifier: Apache-2.0
 */

&flash0 {
	partitions {
		compatible = "fixed-partitions";
		#address-cells = <1>;
		#size-cells = <1>;

		/* 64KB storage partition at the end of the 256KB on-chip flash. */
		storage_partition: partition@30000 {
			label = "storage";
			reg = <0x00030000 DT_SIZE_K(64)>;
		};
	};
};

/*
 * spi_flash0 is left enabled (as in the board's default .dts) since this
 * test's device under test is selected purely by Kconfig (CONFIG_SPI_NOR):
 * see drivers.flash.common.gd32_internal (tests flash0) vs
 * drivers.flash.common.gd32_nor (tests spi_flash0) in testcase.yaml.
 *
 * Board-default SPI0 pins: PF11/SCK, PF12/MISO, PF8/MOSI, PD8/CS.
 * The on-board GD25Q16 is connected through a TXS0108E level shifter,
 * so no pin override is needed here.
 */
