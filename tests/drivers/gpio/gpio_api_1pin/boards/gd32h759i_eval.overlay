/*
 * Copyright (c) 2026 GigaDevice Semiconductor Inc.
 *
 * SPDX-License-Identifier: Apache-2.0
 */

/*
 * Board led0 (PF10) is active-high, which takes the unsupported open-source
 * path; use a free floating active-low pin so open-drain is exercised.
 */
/ {
	test_gpio_leds {
		compatible = "gpio-leds";

		test_gpio_led0: test_gpio_led0 {
			gpios = <&gpioe 3 GPIO_ACTIVE_LOW>;
		};
	};

	aliases {
		led0 = &test_gpio_led0;
	};
};
