## dts/bindings/display/gd,gd32-tli.yaml
```yaml
# Copyright (c) 2025 GigaDevice Semiconductor Inc.
# SPDX-License-Identifier: Apache-2.0

description: GD32 TLI (TFT-LCD Interface) display controller

compatible: "gd,gd32-tli"

include: [base.yaml, pinctrl-device.yaml]

properties:
  reg:
    required: true

  clocks:
    required: true

  disp-en-gpios:
    type: phandle-array
    description: |
      Display enable GPIO signal (optional).
      This signal is used to enable/disable the LCD panel.

  bl-ctrl-gpios:
    type: phandle-array
    description: |
      Backlight control GPIO signal (optional).
      This signal is used to control the LCD backlight on/off.

  hsync:
    type: int
    required: true
    description: Horizontal synchronization pulse width in pixels

  vsync:
    type: int
    required: true
    description: Vertical synchronization pulse width in lines

  hbp:
    type: int
    required: true
    description: Horizontal back porch in pixels

  vbp:
    type: int
    required: true
    description: Vertical back porch in lines

  hfp:
    type: int
    required: true
    description: Horizontal front porch in pixels

  vfp:
    type: int
    required: true
    description: Vertical front porch in lines

  width:
    type: int
    required: true
    description: Active display width in pixels

  height:
    type: int
    required: true
    description: Active display height in lines

  pllsai-n:
    type: int
    required: true
    description: PLLSAI N multiplication factor

  pllsai-r:
    type: int
    required: true
    description: PLLSAI R division factor

  pllsair-div:
    type: int
    required: true
    description: |
      PLLSAI R clock divider for TLI clock
      Valid values: 2, 4, 8, 16 (RCU_PLLSAIR_DIVx)

  pixel-format:
    type: int
    default: 0
    description: |
      Default pixel format for the display.
      Supported values (matching Zephyr display_pixel_format enum):
        0  - PIXEL_FORMAT_RGB_888 (not commonly used, default to RGB565)
        1  - PIXEL_FORMAT_MONO01
        2  - PIXEL_FORMAT_MONO10
        3  - PIXEL_FORMAT_ARGB_8888 (32-bit, 4 bytes per pixel)
        4  - PIXEL_FORMAT_RGB_888 (24-bit, 3 bytes per pixel)
        5  - PIXEL_FORMAT_RGB_565 (16-bit, 2 bytes per pixel) - Default
        6  - PIXEL_FORMAT_BGR_565 (16-bit, 2 bytes per pixel)
      The driver will use RGB565 if not specified.

      GD32 TLI hardware pixel formats (PPF[2:0]):
        000 - ARGB8888  (4 bytes/pixel)
        001 - RGB888    (3 bytes/pixel)
        010 - RGB565    (2 bytes/pixel)
        011 - ARGB1555  (2 bytes/pixel)
        100 - ARGB4444  (2 bytes/pixel)
        101 - L8        (1 byte/pixel)
        110 - AL44      (1 byte/pixel)
        111 - AL88      (2 bytes/pixel)
```

## dts/bindings/dma/gd,gd32-dmamux.yaml
```yaml
# Copyright (c) 2025 GigaDevice Semiconductor Inc.
# SPDX-License-Identifier: Apache-2.0

description: |
  GD32 DMAMUX controller

  GD32 MCUs with DMAMUX (DMA request multiplexer) route peripheral request
  lines to DMA channels. This binding is for MCUs like GD32F50x that have
  a standalone DMAMUX peripheral.

  The DMAMUX acts as a proxy for the underlying DMA controller. Peripherals
  reference the DMAMUX rather than the DMA controller directly.

  Clients connected to the DMAMUX must use a 3-cell DMA specifier:
    1. channel: DMAMUX output channel number (0 .. dma-channels-1)
    2. slot: DMAMUX request line ID (peripheral request selection)
    3. channel-config: A 32-bit mask specifying the DMA channel configuration
       - bit 6-7:   Direction (see dma.h)
                    0x0: MEMORY to MEMORY
                    0x1: MEMORY to PERIPH
                    0x2: PERIPH to MEMORY
                    0x3: reserved
       - bit 9:     Peripheral address increment
                    0x0: no address increment between transfers
                    0x1: increment address between transfers
       - bit 10:    Memory address increment
                    0x0: no address increment between transfers
                    0x1: increment address between transfers
       - bit 11-12: Peripheral data width
                    0x0: Byte (8 bits)
                    0x1: Half-word (16 bits)
                    0x2: Word (32 bits)
                    0x3: reserved
       - bit 13-14: Memory data width
                    0x0: Byte (8 bits)
                    0x1: Half-word (16 bits)
                    0x2: Word (32 bits)
                    0x3: reserved
       - bit 16-17: Priority level
                    0x0: low
                    0x1: medium
                    0x2: high
                    0x3: very high

  Example for GD32F50x:

    dmamux: dmamux@40020800 {
        compatible = "gd,gd32-dmamux";
        reg = <0x40020800 0x400>;
        #dma-cells = <3>;
        dma-channels = <12>;
        dma-generators = <4>;
        dma-requests = <108>;
        clocks = <&cctl GD32_CLOCK_DMAMUX>;
        status = "disabled";
    };

  Example I2C client:

    &i2c0 {
        status = "okay";
        dmas = <&dmamux 0 GD32_DMA_REQ_I2C0_RX 0x00000000>,
               <&dmamux 1 GD32_DMA_REQ_I2C0_TX 0x00000000>;
        dma-names = "rx", "tx";
    };

compatible: "gd,gd32-dmamux"

include: dmamux-controller.yaml

properties:
  reg:
    required: true

  clocks:
    required: true

  "#dma-cells":
    const: 3

  dma-channels:
    required: true
    description: |
      Total number of DMAMUX output channels.
      For GD32F50x: 12 channels (DMA0 CH0-6 + DMA1 CH0-4)

  dma-generators:
    description: |
      Number of request generators supported.
      For GD32F50x: 4 generators

  dma-requests:
    required: true
    description: |
      Number of peripheral request inputs.
      For GD32F50x: 108 request lines

dma-cells:
  - channel
  - slot
  - config
```

## dts/bindings/i2c/gd,gd32-i2c-v2.yaml
```yaml
# Copyright (c) 2025 GigaDevice Semiconductor Inc.
# SPDX-License-Identifier: Apache-2.0

description: GigaDevice GD32 I2C version 2 (for GD32H7XX and newer series)

compatible: "gd,gd32-i2c-v2"

include: [i2c-controller.yaml, reset-device.yaml, pinctrl-device.yaml]

properties:
  reg:
    required: true

  interrupts:
    required: true

  resets:
    required: true

  clocks:
    required: true

  pinctrl-0:
    required: true

  pinctrl-names:
    required: true
```

## dts/bindings/i2c/gd,gd32-i2c-v3.yaml
```yaml
# Copyright (c) 2025 GigaDevice Semiconductor Inc.
# SPDX-License-Identifier: Apache-2.0

description: GigaDevice GD32 I2C version 3

compatible: "gd,gd32-i2c-v3"

include: [i2c-controller.yaml, reset-device.yaml, pinctrl-device.yaml]

properties:
  reg:
    required: true

  interrupts:
    required: true

  resets:
    required: true

  clocks:
    required: true

  pinctrl-0:
    required: true

  pinctrl-names:
    required: true
```

## dts/bindings/mdio/gd,gd32-enet-mdio.yaml
```yaml
#
# Copyright (c) 2026, GigaDevice Semiconductor Inc.
#
# SPDX-License-Identifier: Apache-2.0
#

description: |
  GigaDevice GD32 Ethernet MDIO controller.

  Embedded in the Ethernet MAC registers (ENET_MAC_PHY_CTL/ENET_MAC_PHY_DATA)
  of each MAC instance, so this node is always a child of a
  "gd,gd32-ethernet" node and has no "reg" of its own.

  Note: GD32H7xx also has an unrelated standalone "MDIO" peripheral
  (gd32h7xx_mdio.h) that is not used by, and has no relation to, the
  Ethernet MDIO described here.

compatible: "gd,gd32-enet-mdio"

include: [mdio-controller.yaml, pinctrl-device.yaml]

properties:
  pinctrl-0:
    required: true

  pinctrl-names:
    required: true
```

## dts/bindings/mtd/gd,gd32-nv-flash-v4.yaml
```yaml
# Copyright (c) 2026 GigaDevice Semiconductor Inc.
# SPDX-License-Identifier: Apache-2.0

description: |
  Flash memory binding of GD32 FMC v4.

  GD32 series use this type flash memory:
    - GD32H7xx

include: soc-nv-flash.yaml

compatible: gd,gd32-nv-flash-v4

properties:
  max-erase-time-ms:
    type: int
    required: true
    description: Max erase time(millisecond) of a flash page

  page-size:
    type: int
    required: true
    description: Flash memory page size
```

## dts/bindings/usb/gd,gd32-usbhs.yaml
```yaml
description: |
  GigaDevice GD32 USBHS controller, driven by the legacy Zephyr USB device
  stack through the GD32 USBHS firmware library shim (usb_dc_gd32.c).

compatible: "gd,gd32-usbhs"

include: [usb-ep.yaml, reset-device.yaml]

properties:
  reg:
    required: true

  interrupts:
    required: true

  interrupt-names:
    required: true

  clocks:
    required: true

  resets:
    required: true

  ram-size:
    type: int
    required: true
    description: |
      Size of the USB dedicated RAM (shared FIFO) in bytes.

  phys:
    type: phandle
    description: USB PHY provider specifier.

  gd,usbhs-index:
    type: int
    enum:
      - 0
      - 1
    description: |
      USBHS controller index in the GD32 RCU USB clock control register.
```

## samples/drivers/adc/adc_dt/boards/gd32f503v_eval.conf
```kconfig
# Copyright (c) 2026 GigaDevice Semiconductor Inc.
# SPDX-License-Identifier: Apache-2.0

#CONFIG_ADC_GD32_DMA=y
```

## samples/subsys/display/lvgl/boards/gd32f527i_eval.conf
```kconfig
# Copyright (c) 2026 GigaDevice Semiconductor Inc.
# SPDX-License-Identifier: Apache-2.0
#
# Board-specific config for the LVGL sample on GD32F527I-EVAL.
# Enables the bit-banged SPI bus and the XPT2046 resistive touch driver.

# Bit-banged SPI controller (GPIO-based) for the XPT2046 touch IC
CONFIG_SPI_BITBANG=y

# XPT2046 touch input driver
CONFIG_INPUT_XPT2046=y

# Pipe XPT2046 input events into LVGL as a pointer device
CONFIG_LV_Z_POINTER_INPUT=y

# Input subsystem (required for touch)
CONFIG_INPUT=y
```
