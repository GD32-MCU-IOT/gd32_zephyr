/*
 * Copyright (c) 2026 GigaDevice Semiconductor Inc.
 *
 * SPDX-License-Identifier: Apache-2.0
 */

#include <mem.h>
#include <freq.h>
#include <gd/gd32e23x/gd32e23x.dtsi>

&cpu0 {
	clock-frequency = <DT_FREQ_M(72)>;
};

&flash0 {
	reg = <0x08000000 DT_SIZE_K(64)>;
};

&sram0 {
	reg = <0x20000000 DT_SIZE_K(8)>;
};
