## dts/bindings/clock/gd,gd32f5hc-rcu.yaml
```yaml
# Copyright (c) 2026, GigaDevice Semiconductor Inc.
# SPDX-License-Identifier: Apache-2.0

title: GigaDevice GD32F5HC RCU Clock Tree Configuration

description: |
  GigaDevice GD32F5HC Reset and Clock Unit (RCU) system clock tree
  configuration.

  This binding complements the MFD "gd,gd32-rcu" binding
  (mfd/gd,gd32-rcu.yaml) and models the GD32F5HC system clock source
  selection and the AHB/APB bus prescalers. The RCU node keeps its MFD
  role (parent of the CCTL and RCTL child nodes) and additionally carries
  the clock tree configuration.

  The main PLL configuration is described by the gd,gd32f5hc-pll-clock node
  referenced from "clocks".

  Maximum frequencies (datasheet table 4-3):
    HCLK  200 MHz
    PCLK2 100 MHz
    PCLK1  50 MHz

  Example:

    rcu: reset-clock-controller@40023800 {
        compatible = "gd,gd32f5hc-rcu", "gd,gd32-rcu";
        clocks = <&pll>;               /* Select PLL as SYSCLK source */
        clock-frequency = <DT_FREQ_M(200)>; /* = SYSCLK / AHB prescaler */
        ahb-prescaler = <1>;
        apb1-prescaler = <4>;
        apb2-prescaler = <2>;
    };

compatible: "gd,gd32f5hc-rcu"

include: gd,gd32-rcu.yaml

properties:
  clocks:
    description: |
      System clock source. Reference a gd,gd32f5hc-pll-clock node (PLLP), a
      gd,gd32-hxtal-clock node (HXTAL), a gd,gd32f5hc-irc48m-clock node
      (IRC48M), or a fixed-clock node (IRC16M).

  clock-frequency:
    type: int
    description: |
      Core clock frequency (Hz) = SYSCLK / AHB prescaler.

  ahb-prescaler:
    type: int
    enum:
      - 1
      - 2
      - 4
      - 8
      - 16
      - 64
      - 128
      - 256
      - 512
    description: AHB prescaler. Defines actual core clock frequency (HCLK).

  apb1-prescaler:
    type: int
    enum:
      - 4
      - 8
      - 16
    description: |
      APB1 prescaler. The GD32F5HC RCU_CFG0 APB1PSC encodings below /4 are
      reserved, so PCLK1 can never exceed HCLK/4.

  apb2-prescaler:
    type: int
    enum:
      - 1
      - 2
      - 4
      - 8
      - 16
    description: APB2 prescaler.
```

## dts/bindings/display/gd,gd32-ili9320.yaml
```yaml
description: GD32 EXMC ILI9320 display controller

compatible: "gd,gd32-ili9320"

include: [display-controller.yaml, pinctrl-device.yaml]

properties:
  reg:
    required: true
    description: Command and data register memory addresses.

  clocks:
    required: true

  address-setup-cycles:
    type: int
    required: true
    description: EXMC asynchronous address setup in clock cycles.

  address-hold-cycles:
    type: int
    required: true
    description: EXMC asynchronous address hold in clock cycles.

  data-setup-cycles:
    type: int
    required: true
    description: EXMC asynchronous data setup in clock cycles.

  bus-latency-cycles:
    type: int
    required: true
    description: EXMC bus latency in clock cycles.
```

## dts/bindings/ethernet/gd,gd32-ethernet.yaml
```yaml
#
# Copyright (c) 2026 GigaDevice Semiconductor Inc.
#
# SPDX-License-Identifier: Apache-2.0
#

description: |
  GigaDevice GD32 Ethernet MAC. The MAC is a child of a
  "gd,gd32-ethernet-controller" node that owns the registers ("reg"), and
  the MDIO is its sibling ("enet_mdio: mdio { compatible =
  \"gd,gd32-enet-mdio\"; ... };"). Board dts references both labels as flat,
  independent blocks, e.g.:

    &enet {
        pinctrl-0 = <&enet_rmii_default>;
        pinctrl-names = "default";
        phy-handle = <&phy0>;
        phy-connection-type = "rmii";
        local-mac-address = [00 80 E1 00 00 00];
        ...
    };

    &enet_mdio {
        pinctrl-0 = <&enet_mdio_default>;
        pinctrl-names = "default";
        status = "okay";

        phy0: ethernet-phy@1 {
            compatible = "ethernet-phy";
            reg = <1>;
        };
    };

  This matches the convention used by every other Zephyr peripheral.
  Series with multiple MAC instances (e.g. GD32H73x_75x ENET0/ENET1) repeat
  this pair of labels per instance, unmodified.

compatible: "gd,gd32-ethernet"

include: [ethernet-controller.yaml, reset-device.yaml, pinctrl-device.yaml]

properties:
  interrupts:
    required: true

  resets:
    required: true

  pinctrl-0:
    required: true

  pinctrl-names:
    required: true

  phy-handle:
    required: true

  phy-connection-type:
    required: true
```

## dts/bindings/flash_controller/gd,gd25x512me.yaml
```yaml
# Copyright (c) 2026, GigaDevice Semiconductor Inc.
# SPDX-License-Identifier: Apache-2.0

description: GigaDevice GD25X512ME OSPI NOR flash

compatible: "gd,gd25x512me"

include: gd,gd32-ospi-nor.yaml
```

## dts/bindings/flash_controller/gd,gd32-flash-controller-m53x.yaml
```yaml
# Copyright (c) 2026 GigaDevice Semiconductor Inc.
# SPDX-License-Identifier: Apache-2.0

description: |
  GD32 M53x FMC.

  Up to 256KB main flash and 64KB data flash, both erased in 1KB pages.
  Flash is programmed in 128-bit quad-words, each stored with a 9-bit ECC
  (single-bit correction, double-bit detection). A quad-word can only be
  programmed once per erase cycle, so this FMC is not compatible with the
  v1..v4 variants.

  GD32 series using this FMC:
    - GD32M53x

compatible: "gd,gd32-flash-controller-m53x"

include: gd,gd32-flash-controller.yaml
```

## dts/bindings/flash_controller/gd,gd32-ospi.yaml
```yaml
# Copyright (c) 2026 GigaDevice Semiconductor Inc.
# SPDX-License-Identifier: Apache-2.0

description: GD32 OSPI controller

compatible: "gd,gd32-ospi"

include: [base.yaml, pinctrl-device.yaml]

bus: ospi

properties:
  reg:
    required: true

  interrupts:
    required: true

  clock-names:
    required: true

  clocks:
    required: true

  resets:
    type: phandle-array
    required: true

  pinctrl-0:
    required: true

  pinctrl-names:
    required: true
```

## dts/bindings/flash_controller/gd,gd32f527-flash-controller.yaml
```yaml
# Copyright (c) 2026 GigaDevice Semiconductor Inc.
# SPDX-License-Identifier: Apache-2.0

description: |
  GD32F527 flash controller.

  The FMC drives a single main flash region at 0x08000000. It is programmed
  in 64-bit double-words, each protected by an 8-bit ECC. Pages are 4KB and
  are also the minimum erase unit.

  The main flash is a "gd,gd32-nv-flash" child node that also carries
  "soc-nv-flash", and must use write-block-size = <8> and page-size = <4096>
  (equal to gd,program-unit-bytes and gd,page-bytes); the driver checks both
  at build time.

  This compatible must be listed before "gd,gd32-flash-controller" on the
  FMC node, so this binding applies to the node and its gd,* properties are
  available to the driver.

compatible: "gd,gd32f527-flash-controller"

include: gd,gd32-flash-controller.yaml

properties:
  gd,program-unit-bytes:
    type: int
    required: true
    const: 8
    description: |
      Main flash is programmed in 64-bit double-words, each protected by an
      ECC code.

  gd,ecc-bits:
    type: int
    required: true
    const: 8
    description: ECC bits stored with each double-word of main flash.

  gd,page-bytes:
    type: int
    required: true
    const: 4096
    description: Main flash page size, which is also the minimum erase unit.
```

## dts/bindings/flash_controller/gd,gd32g553-flash-controller.yaml
```yaml
# Copyright (c) 2026 GigaDevice Semiconductor Inc.
# SPDX-License-Identifier: Apache-2.0

description: |
  GD32G5x3 flash controller.

  The FMC is a single-register-set controller (there is no FMC_ADDR):
  page erase selects the target by page number (PNSEL) plus bank number
  (BKSEL) in FMC_CTL, and the main flash is programmed in 64-bit double
  words protected by an 8-bit ECC. In dual-bank mode (OBCTL.DBS = 1) the
  main flash is Bank0 plus Bank1, up to 2 x 256KB, with 1KB pages; a
  double word can only be programmed once per erase cycle.

  The main flash is a "gd,gd32-nv-flash" child node that also carries
  "soc-nv-flash" and must use write-block-size = <8>; the driver checks
  it at build time.

compatible: "gd,gd32g553-flash-controller"

include: flash-controller.yaml
```

## dts/bindings/flash_controller/gd,gd32m53x-flash-controller.yaml
```yaml
# Copyright (c) 2026 GigaDevice Semiconductor Inc.
# SPDX-License-Identifier: Apache-2.0

description: |
  GD32M53x flash controller.

  The FMC drives two regions selected by FMC_CTL.BKSEL: the main flash
  (BKSEL = 0) and a 64KB data flash at 0x08800000 (BKSEL = 1). Both are
  programmed in 128-bit quad-words; main flash keeps a 9-bit ECC per
  quad-word and data flash an 8-bit ECC per 64-bit double-word. A
  quad-word can only be programmed once per erase cycle, and a partially
  written quad-word is discarded by the hardware. Pages are 1KB in both
  regions.

  Both regions are "gd,gd32-nv-flash" child nodes and must use
  write-block-size = <16> and page-size = <1024>; the driver checks both
  at build time. The main flash node also carries "soc-nv-flash". The data
  flash node does not, and the driver exposes it as its own flash device.

compatible: "gd,gd32m53x-flash-controller"

include: flash-controller.yaml
```

## dts/bindings/mtd/gd,gd32-nv-flash-f527.yaml
```yaml
# Copyright (c) 2026 GigaDevice Semiconductor Inc.
# SPDX-License-Identifier: Apache-2.0

description: |
  Flash memory binding of GD32 F527 FMC.

  The F527 FMC erases the main flash in 4 KB pages through FMC_PECFG and
  programs it in 64-bit double-words protected by an 8-bit ECC. Its register
  layout differs from the v1..v4 backends.

  GD32 series use this type flash memory:
    - GD32F527

include: soc-nv-flash.yaml

compatible: "gd,gd32-nv-flash-f527"

properties:
  max-erase-time-ms:
    type: int
    required: true
    description: Max erase time(millisecond) of a flash page

  page-size:
    type: int
    required: true
    description: Flash memory page size

  write-block-size:
    required: true
    type: int
    enum:
      - 8
    description: |
      Number of bytes used in write operations. The FMC programs the flash in
      64-bit double-words.
```

## dts/bindings/mtd/gd,gd32-nv-flash-m53x.yaml
```yaml
# Copyright (c) 2025 GigaDevice Semiconductor Inc.
# SPDX-License-Identifier: Apache-2.0

description: |
  Flash memory binding of GD32 M53x FMC.

  The M53x FMC programs the main flash in 128-bit quad-words protected by a
  9-bit ECC. A quad-word can only be programmed once per erase cycle, and a
  partially programmed quad-word is silently discarded by the hardware, so
  this FMC is not compatible with the v1..v4 backends.

  GD32 series use this type flash memory:
    - GD32M53x

include: soc-nv-flash.yaml

compatible: "gd,gd32-nv-flash-m53x"

properties:
  max-erase-time-ms:
    type: int
    required: true
    description: Max erase time(millisecond) of a flash page

  page-size:
    type: int
    required: true
    description: Flash memory page size
```
