## boards/gd/gd32c113v_eval/Kconfig.gd32c113v_eval
```kconfig
# Copyright (c) 2026, GigaDevice Semiconductor Inc.
# SPDX-License-Identifier: Apache-2.0

config BOARD_GD32C113V_EVAL
	select SOC_GD32C113
```

## boards/gd/gd32c113v_eval/board.yml
```yaml
board:
  name: gd32c113v_eval
  full_name: GD32C113V-EVAL
  vendor: gd
  socs:
    - name: gd32c113
```

## boards/gd/gd32c113v_eval/gd32c113v_eval_defconfig
```kconfig
# Copyright (c) 2026, GigaDevice Semiconductor Inc.
# SPDX-License-Identifier: Apache-2.0

CONFIG_GD32_HXTAL_8MHZ=y

CONFIG_CONSOLE=y
CONFIG_UART_CONSOLE=y
CONFIG_SERIAL=y
CONFIG_GPIO=y
```

## boards/gd/gd32c231k_start/board.yml
```yaml
board:
  name: gd32c231k_start
  full_name: GD32C231K-START
  vendor: gd
  socs:
    - name: gd32c231
```

## boards/gd/gd32e508z_eval/board.yml
```yaml
board:
  name: gd32e508z_eval
  full_name: GD32E508Z-EVAL
  vendor: gd
  socs:
    - name: gd32e508
```

## boards/gd/gd32e517z_eval/Kconfig.gd32e517z_eval
```kconfig
# Copyright (c) 2026 GigaDevice Semiconductor Inc.
# SPDX-License-Identifier: Apache-2.0

config BOARD_GD32E517Z_EVAL
	select SOC_GD32E517
```

## boards/gd/gd32e517z_eval/board.yml
```yaml
board:
  name: gd32e517z_eval
  full_name: GD32E517Z-EVAL
  vendor: gd
  socs:
    - name: gd32e517
```

## boards/gd/gd32f303b_start/board.yml
```yaml
board:
  name: gd32f303b_start
  full_name: GD32F303B-START
  vendor: gd
  socs:
    - name: gd32f303
```

## boards/gd/gd32f307c_eval/Kconfig.gd32f307c_eval
```kconfig
# Copyright (c) 2026, GigaDevice Semiconductor Inc.
# SPDX-License-Identifier: Apache-2.0

config BOARD_GD32F307C_EVAL
	select SOC_GD32F307
```

## boards/gd/gd32f307c_eval/board.yml
```yaml
board:
  name: gd32f307c_eval
  full_name: GD32F307C-EVAL
  vendor: gd
  socs:
    - name: gd32f307
```

## boards/gd/gd32f503v_eval/Kconfig.gd32f503v_eval
```kconfig
# Copyright (c) 2025, GigaDevice Semiconductor Inc.
# SPDX-License-Identifier: Apache-2.0

config BOARD_GD32F503V_EVAL
	select SOC_GD32F503
```

## boards/gd/gd32f503v_eval/board.yml
```yaml
board:
  name: gd32f503v_eval
  full_name: GD32F503V-EVAL
  vendor: gd
  socs:
    - name: gd32f503
```

## boards/gd/gd32f5hcr_eval/Kconfig.gd32f5hcr_eval
```kconfig
# Copyright (c) 2026 GigaDevice Semiconductor Inc.
# SPDX-License-Identifier: Apache-2.0

config BOARD_GD32F5HCR_EVAL
	select SOC_GD32W51X_F5HC
```

## boards/gd/gd32f5hcr_eval/board.yml
```yaml
board:
  name: gd32f5hcr_eval
  full_name: GD32F5HCR-EVAL
  vendor: gd
  socs:
    - name: gd32w51x_f5hc
```

## boards/gd/gd32g553q_eval/board.yml
```yaml
board:
  name: gd32g553q_eval
  full_name: GD32G553Q-EVAL
  vendor: gd
  socs:
    - name: gd32g553
```

## boards/gd/gd32h759i_eval/Kconfig.defconfig
```kconfig
# Copyright (c) 2026 GigaDevice Semiconductor Inc.
# SPDX-License-Identifier: Apache-2.0

if BOARD_GD32H759I_EVAL

config BOARD
	default "gd32h759i_eval"

endif # BOARD_GD32H759I_EVAL
```

## boards/gd/gd32h759i_eval/Kconfig.gd32h759i_eval
```kconfig
# Copyright (c) 2026 GigaDevice Semiconductor Inc.
# SPDX-License-Identifier: Apache-2.0

config BOARD_GD32H759I_EVAL
	bool "GigaDevice GD32H759I-EVAL"
	select SOC_GD32H759

config CACHE_OPERATION
	bool "cache maintenance operations using CMSIS"
```

## boards/gd/gd32h759i_eval/board.yml
```yaml
board:
  name: gd32h759i_eval
  full_name: GD32H759I-EVAL
  vendor: gd
  socs:
    - name: gd32h759
```

## boards/gd/gd32h759i_eval/gd32h759i_eval_defconfig
```kconfig
# Copyright (c) 2026 GigaDevice Semiconductor Inc.
# SPDX-License-Identifier: Apache-2.0

CONFIG_BOARD_GD32H759I_EVAL=y

CONFIG_ARM_MPU=y
CONFIG_HW_STACK_PROTECTION=y

CONFIG_CONSOLE=y
CONFIG_UART_CONSOLE=y
CONFIG_SERIAL=y

CONFIG_GPIO=y

CONFIG_PWM=y

CONFIG_CACHE_MANAGEMENT=y

# CONFIG_CACHE_OPERATION=y
```

## boards/gd/gd32h759i_start/Kconfig.defconfig
```kconfig
# Copyright (c) 2026 GigaDevice Semiconductor Inc.
# SPDX-License-Identifier: Apache-2.0

if BOARD_GD32H759I_START

config BOARD
	default "gd32h759i_start"

endif # BOARD_GD32H759I_START
```

## boards/gd/gd32h759i_start/Kconfig.gd32h759i_start
```kconfig
# Copyright (c) 2026 GigaDevice Semiconductor Inc.
# SPDX-License-Identifier: Apache-2.0

config BOARD_GD32H759I_START
	select SOC_GD32H759
```

## boards/gd/gd32h759i_start/board.yml
```yaml
board:
  name: gd32h759i_start
  full_name: GD32H759I-START
  vendor: gd
  socs:
    - name: gd32h759
```

## boards/gd/gd32h75ey_eval/Kconfig
```kconfig
# Copyright (c) 2026 GigaDevice Semiconductor Inc.
# SPDX-License-Identifier: Apache-2.0

config BOARD_INIT_PRIORITY
	int "Board initialization priority"
	default 50
	help
	  Board initialization priority.
```

## boards/gd/gd32h75ey_eval/Kconfig.defconfig
```kconfig
# Copyright (c) 2026 GigaDevice Semiconductor Inc.
# SPDX-License-Identifier: Apache-2.0

if BOARD_GD32H75EY_EVAL

config BOARD
	default "gd32h75ey_eval"

endif # BOARD_GD32H75EY_EVAL
```

## boards/gd/gd32h75ey_eval/Kconfig.gd32h75ey_eval
```kconfig
# Copyright (c) 2026 GigaDevice Semiconductor Inc.
# SPDX-License-Identifier: Apache-2.0

config BOARD_GD32H75EY_EVAL
	bool "GigaDevice GD32H75EY-EVAL"
	select SOC_GD32H75E

config CACHE_OPERATION
	bool "cache maintenance operations using CMSIS"
```
