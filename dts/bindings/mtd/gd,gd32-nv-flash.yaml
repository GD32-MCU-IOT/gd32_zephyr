## dts/bindings/mtd/gd,gd32-nv-flash.yaml
```yaml
# Copyright (c) 2026 GigaDevice Semiconductor Inc.
# SPDX-License-Identifier: Apache-2.0

description: |
  GD32 flash memory.

  This binding is for the flash memory itself, not the flash controller
  peripheral. For that, see the "gd,gd32-flash-controller" binding and the
  series bindings such as "gd,gd32m53x-flash-controller".

  Page layout properties. Which one to use depends only on how the flash
  pages are laid out, not on the FMC type: series sharing a layout may still
  differ in FMC, write-block-size and driver.

    - Equal pages across the whole node: use page-size.
      Used by FMC v1 series, FMC v4 series and GD32M53x.
    - Two banks, each with its own page size: use bank0-page-size and
      bank1-page-size.
      Used by FMC v2 series.
    - Sectors of different sizes: no layout property, the sector map is
      fixed in the driver.
      Used by FMC v3 series.

include: soc-nv-flash.yaml

compatible: "gd,gd32-nv-flash"

properties:
  max-erase-time-ms:
    type: int
    required: true
    description: Max erase time(millisecond) of a flash page or sector

  page-size:
    type: int
    description: Flash memory page size, for a bank of equal pages

  bank0-page-size:
    type: int
    description: Flash memory page size for bank0

  bank1-page-size:
    type: int
    description: Flash memory page size for bank1
```

## dts/bindings/sensor/gd,gd32-qdec.yaml
```yaml
# Copyright (c) 2026 GigaDevice Semiconductor Inc.
# SPDX-License-Identifier: Apache-2.0

description: GD32 timer quadrature decoder

compatible: "gd,gd32-qdec"

include:
  - name: base.yaml
  - name: pinctrl-device.yaml
  - name: sensor-device.yaml
  - name: reset-device.yaml

properties:
  reg:
    required: true

  interrupts:
    required: true

  clocks:
    required: true

  resets:
    required: true

  pinctrl-0:
    required: true

  pinctrl-names:
    required: true

  gd,encoder-mode:
    type: int
    default: 3
    enum: [1, 2, 3]
    description: GD32 TIMER encoder mode (TIMER_ENCODER_MODE0..2).

  gd,input-filter:
    type: int
    default: 0
    enum: [0, 1, 2, 3, 4, 5, 6, 7, 8, 9, 10, 11, 12, 13, 14, 15]
    description: Digital input filter value for both encoder channels.

  gd,invert-direction:
    type: boolean
    description: Invert the logical count direction without swapping the encoder inputs.
```

## dts/bindings/spi/gd,gd32-spi.yaml
```yaml
# Copyright (c) 2021 BrainCo Inc.
# SPDX-License-Identifier: Apache-2.0

description: GigaDevice GD32 SPI

compatible: "gd,gd32-spi"

include: [spi-controller.yaml, reset-device.yaml, pinctrl-device.yaml]

properties:
  reg:
    required: true

  interrupts:
    required: true

  resets:
    required: true

  clocks:
    required: true

  pinctrl-0:
    required: true

  pinctrl-names:
    required: true

  quad-capable:
    type: boolean
    description: |
      This instance implements the SPI_QCTL register and supports quad wire
      mode. Quad wire mode is master only, half duplex and 8-bit frames only.
      It also requires cs-gpios, because entering and leaving quad mode
      toggles SPIEN, which would release a hardware driven NSS in the middle
      of a transaction.
```

## soc/gd/gd32/gd32e23x/Kconfig
```kconfig
# Copyright (c) 2026 GigaDevice Semiconductor Inc.
# SPDX-License-Identifier: Apache-2.0

config SOC_SERIES_GD32E23X
	select ARM
	select CPU_CORTEX_M23
	select CPU_CORTEX_M_HAS_SYSTICK
	select CPU_CORTEX_M_HAS_VTOR
	select GD32_HAS_AF_PINMUX
	select GD32_HAS_IRC_40K
	select SOC_EARLY_INIT_HOOK
```

## soc/gd/gd32/gd32e23x/Kconfig.soc
```kconfig
# Copyright (c) 2026 GigaDevice Semiconductor Inc.
# SPDX-License-Identifier: Apache-2.0

config SOC_SERIES_GD32E23X
	bool
	select SOC_FAMILY_GD_GD32
	help
	  Enable support for GigaDevice GD32E23x MCU series

config SOC_SERIES
	default "gd32e23x" if SOC_SERIES_GD32E23X

config SOC_GD32E230
	bool
	select SOC_SERIES_GD32E23X

config SOC
	default "gd32e230" if SOC_GD32E230
```

## soc/gd/gd32/gd32h73x_75x/Kconfig.soc
```kconfig
# Copyright (c) 2026 GigaDevice Semiconductor Inc.
# SPDX-License-Identifier: Apache-2.0

config SOC_SERIES_GD32H73X_75X
	bool
	select SOC_FAMILY_GD_GD32
	help
	  Enable support for GigaDevice GD32H73x/GD32H75x MCU series

config SOC_SERIES
	default "gd32h73x_75x" if SOC_SERIES_GD32H73X_75X

config SOC_GD32H759
	bool
	select SOC_SERIES_GD32H73X_75X

config SOC_GD32H75E
	bool
	select SOC_SERIES_GD32H73X_75X

config SOC
	default "gd32h759" if SOC_GD32H759
	default "gd32h75e" if SOC_GD32H75E
```

## soc/gd/gd32/gd32l23x/Kconfig.defconfig.gd32l235
```kconfig
# SPDX-FileCopyrightText: Copyright The Zephyr Project Contributors
# SPDX-License-Identifier: Apache-2.0

if SOC_GD32L235

config SYS_CLOCK_HW_CYCLES_PER_SEC
	default $(dt_node_int_prop_int,/cpus/cpu@0,clock-frequency)

config NUM_IRQS
	default 72

endif # SOC_GD32L235
```

## soc/gd/gd32/gd32m53x/Kconfig.defconfig.series
```kconfig
# Copyright (c) 2026 GigaDevice Semiconductor Inc.
# SPDX-License-Identifier: Apache-2.0

if SOC_SERIES_GD32M53X

rsource "Kconfig.defconfig.gd32m531"
endif # SOC_SERIES_GD32M53X
```

## tests/drivers/flash/common/boards/gd32g553q_eval_internal.conf
```kconfig
# Copyright (c) 2026 GigaDevice Semiconductor Inc.
# SPDX-License-Identifier: Apache-2.0

CONFIG_SPI_NOR=n

CONFIG_TEST_DRIVER_FLASH_SIZE=524288
```
