/*
 * Copyright (c) 2026 GigaDevice Semiconductor Inc.
 *
 * SPDX-License-Identifier: Apache-2.0
 */

#include <mem.h>
#include <freq.h>
#include <gd/gd32w51x_f5hc/gd32w51x_f5hc.dtsi>

&cpu0 {
	clock-frequency = <DT_FREQ_M(200)>;
};

&flash0 {
	reg = <0x08000000 DT_SIZE_K(2048)>;
};
