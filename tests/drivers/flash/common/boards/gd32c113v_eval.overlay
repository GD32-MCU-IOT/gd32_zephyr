/*
 * Copyright (c) 2026 GigaDevice Semiconductor Inc.
 *
 * SPDX-License-Identifier: Apache-2.0
 */

&flash0 {
	partitions {
		compatible = "fixed-partitions";
		#address-cells = <1>;
		#size-cells = <1>;

		/* 32KB storage partition at the end of the 128KB on-chip flash. */
		storage_partition: partition@18000 {
			label = "storage";
			reg = <0x00018000 DT_SIZE_K(32)>;
		};
	};
};

/*
 * nor_flash is left enabled (as in the board's default .dts) since this
 * test's device under test is selected purely by Kconfig (CONFIG_SPI_NOR):
 * drivers.flash.common.default (tests nor_flash, board default conf) vs
 * drivers.flash.common.gd32c113_internal (tests flash0, internal conf).
 */
