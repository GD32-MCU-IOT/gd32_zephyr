## boards/gd/gd32e230c_eval/Kconfig.gd32e230c_eval
```kconfig
# Copyright (c) 2026 GigaDevice Semiconductor Inc.
# SPDX-License-Identifier: Apache-2.0

config BOARD_GD32E230C_EVAL
	select SOC_GD32E230
```

## boards/gd/gd32e230c_eval/board.yml
```yaml
board:
  name: gd32e230c_eval
  full_name: GD32E230C-EVAL
  vendor: gd
  socs:
    - name: gd32e230
```

## boards/gd/gd32l235r_eval/Kconfig.gd32l235r_eval
```kconfig
# SPDX-FileCopyrightText: Copyright The Zephyr Project Contributors
# SPDX-License-Identifier: Apache-2.0

config BOARD_GD32L235R_EVAL
	select SOC_GD32L235
```

## boards/gd/gd32l235r_eval/board.yml
```yaml
# SPDX-FileCopyrightText: Copyright The Zephyr Project Contributors
# SPDX-License-Identifier: Apache-2.0

board:
  name: gd32l235r_eval
  full_name: GD32L235R-EVA
  vendor: gd
  socs:
    - name: gd32l235
```

## drivers/clock_control/Kconfig.gd32
```kconfig
# Copyright (c) 2022 Teslabs Engineering S.L.
# Copyright (c) 2026, GigaDevice Semiconductor Inc.
# SPDX-License-Identifier: Apache-2.0

config CLOCK_CONTROL_GD32
	bool "GD32 clock control"
	default y
	depends on DT_HAS_GD_GD32_CCTL_ENABLED
	help
	  Enable driver for Gigadevice Reset Clock Unit (RCU).

config CLOCK_CONTROL_GD32_CKOUT
	bool "GD32 CKOUT clock output"
	default y
	depends on DT_HAS_GD_GD32_CLOCK_CKOUT_ENABLED
	help
	  Enable driver for GD32 CKOUT clock output configuration.

config CLOCK_CONTROL_GD32_PLL
	bool "GD32 PLL/system clock DTS configuration"
	depends on DT_HAS_GD_GD32F527_RCU_ENABLED
	depends on SOC_SERIES_GD32F527
	help
	  Enable DTS-driven PLL and system clock tree configuration for the
	  GD32F527. When enabled, the main PLL, AHB/APB prescalers and system
	  clock source are configured from the devicetree during PRE_KERNEL_1.
```

## drivers/display/Kconfig.gd32_ili9320
```kconfig
# Copyright (c) 2026 GigaDevice Semiconductor Inc.
# SPDX-License-Identifier: Apache-2.0

config GD32_ILI9320
	bool "GD32 EXMC ILI9320 display driver"
	default y
	depends on DT_HAS_GD_GD32_ILI9320_ENABLED
	depends on SOC_SERIES_GD32F50X
	select USE_GD32_EXMC
	select PINCTRL
	help
	  Enable driver for the ILI9320 16-bit parallel display connected to
	  the GD32 EXMC. Currently supported on GD32F50x.
```

## drivers/flash/Kconfig.gd32_ospi
```kconfig
# Copyright (c) 2026 GigaDevice Semiconductor Inc.
# SPDX-License-Identifier: Apache-2.0

config FLASH_GD32_OSPI
	bool "GD32 OSPI NOR flash driver"
	default y
	depends on DT_HAS_GD_GD32_OSPI_NOR_ENABLED
	depends on SOC_SERIES_GD32H7XX || SOC_SERIES_GD32H75E
	select FLASH_HAS_DRIVER_ENABLED
	select FLASH_HAS_PAGE_LAYOUT
	select FLASH_HAS_EXPLICIT_ERASE
	select FLASH_JESD216
	select PINCTRL
	select CLOCK_CONTROL
	select RESET
	select USE_GD32_OSPI
	select USE_GD32_RCU
	help
	  Enable GD32 OSPI NOR support on GD32H7 class processors.

config FLASH_GD32_OSPI_MEMORY_MAPPED
	bool "GD32 OSPI memory-mapped (XIP-style) read support"
	default n
	depends on FLASH_GD32_OSPI
	help
	  When enabled, flash_read() on the GD32 OSPI NOR driver switches the
	  OSPI controller into memory-mapped mode and reads the data directly
	  via CPU load instructions from the controller's memory window,
	  instead of issuing an indirect-mode read command. flash_write() and
	  flash_erase() always take the controller back to indirect mode
	  first, so memory-mapped mode is only ever active across read calls.
```

## drivers/sensor/qdec_gd32/Kconfig
```kconfig
# Copyright (c) 2026 GigaDevice Semiconductor Inc.
# SPDX-License-Identifier: Apache-2.0

config QDEC_GD32
	bool "GD32 timer quadrature decoder"
	default y
	depends on DT_HAS_GD_GD32_QDEC_ENABLED
	select PINCTRL
	select USE_GD32_TIMER
	help
	  Enable the GD32 timer quadrature decoder sensor driver.

	  The timer reports wraps through a single sticky update flag, which does
	  not latch the number of wraps or their direction. The driver samples
	  TIMER_CNT before clearing the flag; a wrap arriving after the clear
	  re-asserts the flag and is handled separately. A wrap arriving in the
	  short window between the counter sample and the flag clear coalesces
	  with the pending one and cannot be reconstructed in software. Opposite
	  wraps that coalesce before servicing cannot be reconstructed either, so
	  the update interrupt must be serviced at least once per half of the
	  16-bit counter range.
```

## dts/bindings/can/gd,gd32-can-v2.yaml
```yaml
# Copyright (c) 2026, GigaDevice Semiconductor Inc.
# SPDX-License-Identifier: Apache-2.0

description: |
  GD32 CAN-V2 controller (GD32H7xx / GD32A50x / GD32G5).

  This FlexCAN-style CAN-V2 IP is register-incompatible with the classic bxCAN
  block described by the "gd,gd32-can" binding. It is handled by a dedicated
  driver (can_gd32_v2.c). Classic CAN 2.0B and CAN FD (ISO 11898-1:2015)
  operation is supported when CONFIG_CAN_GD32_CAN_V2_FD is enabled.

compatible: "gd,gd32-can-v2"

include: [can-fd-controller.yaml, pinctrl-device.yaml]

properties:
  reg:
    required: true

  interrupts:
    required: true

  clocks:
    required: true

  pinctrl-0:
    required: true

  pinctrl-names:
    required: true

  sjw:
    type: int
    description: Synchronization jump width in time quanta (1-32)

  sjw-data:
    type: int
    description: Synchronization jump width for data phase in time quanta (CAN FD, 1-8)

  prop-seg-data:
    type: int
    description: Propagation time segment for data phase in time quanta (CAN FD)

  phase-seg1-data:
    type: int
    description: Phase buffer segment 1 for data phase in time quanta (CAN FD, 1-8)

  phase-seg2-data:
    type: int
    description: Phase buffer segment 2 for data phase in time quanta (CAN FD, 1-8)
```

## dts/bindings/clock/gd,gd32-pll-clock.yaml
```yaml
# Copyright (c) 2026, GigaDevice Semiconductor Inc.
# SPDX-License-Identifier: Apache-2.0

title: GigaDevice GD32 Main PLL Clock

description: |
  GigaDevice GD32 main PLL clock node.

  This node models the main PLL used to generate the system clock. It takes
  one of gd,gd32-hxtal-clock or gd,gd32-cctl (IRC16M) as input clock, and
  produces a single output clock (PLL_P).

  This binding applies to GD32 series that expose a dedicated RCU_PLL
  register with PSC/N/P/Q fields, such as GD32F527 and GD32F4xx.

  The output frequency is computed as:

    f(CK_PLLP) = f(VCO clock) / PLLP

      with f(VCO clock) = f(PLL input clock) / PLLPSC * PLLN

  The PLL input clock source is selected by the "clocks" property: a
  gd,gd32-hxtal-clock node selects HXTAL, a fixed-clock node selects IRC16M.
  This maps to the RCU_PLLSRC_* bit in RCU_PLL.

  Property mapping to rcu_pll_config() arguments:
    pll-psc  : PLL VCO source clock prescaler (2..63)
    pll-n    : PLL VCO clock multiplication factor (64..500)
    pll-p    : PLLP output division factor (2, 4, 6, 8)
    pll-q    : PLLQ output division factor (2..15)

compatible: "gd,gd32-pll-clock"

include: [clock-controller.yaml, base.yaml]

properties:
  "#clock-cells":
    const: 0

  clocks:
    required: true
    description: |
      PLL input clock source. Reference either a gd,gd32-hxtal-clock node
      (HXTAL) or a fixed-clock node (IRC16M).

  pll-psc:
    type: int
    required: true
    description: |
        PLL VCO source clock prescaler.
        Valid range: 2 - 63

  pll-n:
    type: int
    required: true
    description: |
        PLL VCO clock multiplication factor.
        Valid range: 64 - 500

  pll-p:
    type: int
    required: true
    description: PLLP output frequency division factor.
    enum:
      - 2
      - 4
      - 6
      - 8

  pll-q:
    type: int
    required: true
    description: |
        PLLQ output frequency division factor.
        Valid range: 2 - 15
```

## dts/bindings/clock/gd,gd32f527-rcu.yaml
```yaml
# Copyright (c) 2026, GigaDevice Semiconductor Inc.
# SPDX-License-Identifier: Apache-2.0

title: GigaDevice GD32F527 RCU Clock Tree Configuration

description: |
  GigaDevice GD32F527 Reset and Clock Unit (RCU) system clock tree
  configuration.

  This binding complements the MFD "gd,gd32-rcu" binding
  (mfd/gd,gd32-rcu.yaml) and models the GD32F527 system clock source
  selection and the AHB/APB bus prescalers. The RCU node keeps its MFD
  role (parent of the CCTL and RCTL child nodes) and additionally carries
  the clock tree configuration.

  GD32F527 exposes a dedicated RCU_PLL register with PSC/N/P/Q fields.
  The main PLL configuration is described by the gd,gd32-pll-clock node
  referenced from "clocks".

  Example:

    rcu: reset-clock-controller@40023800 {
        compatible = "gd,gd32f527-rcu", "gd,gd32-rcu";
        clocks = <&pll>;               /* Select PLL as SYSCLK source */
        clock-frequency = <DT_FREQ_M(200)>; /* = SYSCLK / AHB prescaler */
        ahb-prescaler = <1>;
        apb1-prescaler = <4>;
        apb2-prescaler = <2>;
    };

compatible: "gd,gd32f527-rcu"

include: gd,gd32-rcu.yaml

properties:
  clocks:
    description: |
      System clock source. Reference a gd,gd32-pll-clock node (PLL), a
      gd,gd32-hxtal-clock node (HXTAL), or a fixed-clock node (IRC16M).

  clock-frequency:
    type: int
    description: |
      Core clock frequency (Hz) = SYSCLK / AHB prescaler.

  ahb-prescaler:
    type: int
    enum:
      - 1
      - 2
      - 4
      - 8
      - 16
      - 64
      - 128
      - 256
      - 512
    description: AHB prescaler. Defines actual core clock frequency (HCLK).

  apb1-prescaler:
    type: int
    enum:
      - 1
      - 2
      - 4
      - 8
      - 16
    description: APB1 prescaler.

  apb2-prescaler:
    type: int
    enum:
      - 1
      - 2
      - 4
      - 8
      - 16
    description: APB2 prescaler.
```

## dts/bindings/clock/gd,gd32f5hc-irc48m-clock.yaml
```yaml
# Copyright (c) 2026, GigaDevice Semiconductor Inc.
# SPDX-License-Identifier: Apache-2.0

title: GigaDevice GD32F5HC IRC48M Internal Clock

description: |
  GigaDevice GD32F5HC internal 48 MHz RC oscillator (IRC48M).

  This node models the IRC48M as a fixed-rate clock source. It is referenced
  through a "clocks" property to select IRC48M as the main PLL input or as
  the system clock source.

  Note that the factory trimming of IRC48M is not accurate enough for USB
  use without the runtime trimming performed by the CTC unit.

compatible: "gd,gd32f5hc-irc48m-clock"

# fixed-clock provides clock-frequency and "#clock-cells" definitions.
include: [fixed-clock.yaml]
```

## dts/bindings/clock/gd,gd32f5hc-pll-clock.yaml
```yaml
# Copyright (c) 2026, GigaDevice Semiconductor Inc.
# SPDX-License-Identifier: Apache-2.0

title: GigaDevice GD32F5HC Main PLL Clock

description: |
  GigaDevice GD32F5HC main PLL clock node.

  Reuses the gd,gd32-pll-clock properties except pll-q, as the GD32F5HC
  RCU_PLL register has no PLLQ field. The PLL input can additionally be the
  fixed-clock node labeled irc48m (IRC48M).

  Hardware constraints (user manual 6.7.2, datasheet table 4-24):
    f(VCO source clock) must be within 1 MHz .. 2 MHz
    f(VCO clock)        must be within 64 MHz .. 500 MHz

  Spread spectrum modulation is optional and only applies to the main PLL.
  When enabled, the valid PLLN range narrows to 69..504 (center spread) or
  71..508 (down spread).

compatible: "gd,gd32f5hc-pll-clock"

include:
  - name: gd,gd32-pll-clock.yaml
    property-blocklist:
      - pll-q

properties:
  clocks:
    description: |
      PLL input clock source. Reference a gd,gd32-hxtal-clock node (HXTAL),
      the fixed-clock node labeled irc48m (IRC48M) or another fixed-clock
      node (IRC16M).

  pll-n:
    description: |
      PLL VCO clock multiplication factor.
      Valid range: 64 - 511

  spread-spectrum:
    type: boolean
    description: |
      Enable spread spectrum modulation on the main PLL clock. Requires
      ss-modulation-freq and ss-modulation-depth to be set.

  ss-type:
    type: string
    default: "center"
    enum:
      - "center"
      - "down"
    description: Spread spectrum modulation type.

  ss-modulation-freq:
    type: int
    description: |
      Spread spectrum modulation frequency in Hz. Used to compute MODCNT as
      round(f(VCO source clock) / 4 / ss-modulation-freq).

  ss-modulation-depth:
    type: int
    description: |
      Spread spectrum modulation amplitude in units of 0.1 %. For example 20
      selects a 2.0 % modulation depth.
```

## dts/bindings/clock/gd,gd32f5hc-plli2s-clock.yaml
```yaml
# Copyright (c) 2026, GigaDevice Semiconductor Inc.
# SPDX-License-Identifier: Apache-2.0

title: GigaDevice GD32F5HC PLLI2S Clock

description: |
  GigaDevice GD32F5HC PLLI2S clock node.

  PLLI2S shares its input source selector (RCU_PLL PLLSEL) with the main
  PLL, but has its own prescaler, multiplication factor and output divider
  in RCU_PLLCFG.

  The output frequency is computed as:

    f(CK_PLLI2S) = f(PLLI2S VCO clock) / PLLI2SDIV

      with f(PLLI2S VCO clock) = f(PLLI2S VCO source clock) * PLLI2SN
      and  f(PLLI2S VCO source clock) = f(PLL input clock) / PLLI2SPSC

  Hardware constraints (user manual 6.7.23, datasheet table 4-25):
    f(PLLI2S VCO source clock) must be within 2 MHz .. 16 MHz
    f(PLLI2S VCO clock)        must not exceed 550 MHz

  plli2s-div carries the raw RCU_PLLCFG PLLI2SDIV field encoding because the
  divider supports half steps that cannot be expressed as an integer ratio:
  0 selects /32, 3 selects /1.5, 4 selects /2, 5 selects /2.5 and so on up
  to 63 which selects /31.5. Values 1 and 2 are reserved.

compatible: "gd,gd32f5hc-plli2s-clock"

include: [clock-controller.yaml, base.yaml]

properties:
  "#clock-cells":
    const: 0

  plli2s-psc:
    type: int
    required: true
    description: |
      PLLI2S VCO source clock prescaler.
      Valid range: 1 - 8

  plli2s-n:
    type: int
    required: true
    description: |
      PLLI2S VCO clock multiplication factor.
      Valid range: 8 - 127

  plli2s-div:
    type: int
    required: true
    description: |
      Raw RCU_PLLCFG PLLI2SDIV field value selecting the PLLI2S output
      divider. Valid range: 0, 3 - 63 (1 and 2 are reserved).
```
