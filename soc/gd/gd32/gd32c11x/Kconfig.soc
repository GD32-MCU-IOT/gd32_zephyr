## soc/gd/gd32/gd32c11x/Kconfig.soc
```kconfig
# Copyright (c) 2026, GigaDevice Semiconductor Inc.
# SPDX-License-Identifier: Apache-2.0

config SOC_SERIES_GD32C11X
	bool
	select SOC_FAMILY_GD_GD32
	help
	  Enable support for GigaDevice GD32C11X MCU series

config SOC_SERIES
	default "gd32c11x" if SOC_SERIES_GD32C11X

config SOC_GD32C113
	bool
	select SOC_SERIES_GD32C11X

config SOC
	default "gd32c113" if SOC_GD32C113
```

## soc/gd/gd32/gd32c2x1/Kconfig.defconfig.series
```kconfig
# Copyright (c) 2025 GigaDevice Semiconductor Inc.
# SPDX-License-Identifier: Apache-2.0

if SOC_SERIES_GD32C2X1

rsource "Kconfig.defconfig.gd32*"

endif # SOC_SERIES_GD32C2X1
```

## soc/gd/gd32/gd32c2x1/Kconfig.soc
```kconfig
# Copyright (c) 2025, GigaDevice Semiconductor Inc.
# SPDX-License-Identifier: Apache-2.0

config SOC_SERIES_GD32C2X1
	bool
	select SOC_FAMILY_GD_GD32
	help
	  Enable support for GigaDevice GD32C2X1 MCU series

config SOC_SERIES
	default "gd32c2x1" if SOC_SERIES_GD32C2X1

config SOC_GD32C231
	bool
	select SOC_SERIES_GD32C2X1

config SOC_GD32C231C8
	bool
	select SOC_GD32C231

config SOC_GD32C231K8
	bool
	select SOC_GD32C231

config SOC
	default "gd32c231c8" if SOC_GD32C231C8
	default "gd32c231k8" if SOC_GD32C231K8
	default "gd32c231" if SOC_GD32C231
```

## soc/gd/gd32/gd32e51x/Kconfig
```kconfig
# Copyright (c) 2026 GigaDevice Semiconductor Inc.
# SPDX-License-Identifier: Apache-2.0

config SOC_SERIES_GD32E51X
	select ARM
	select CPU_HAS_ARM_MPU
	select CPU_HAS_FPU
	select CPU_CORTEX_M33
	select ARMV8_M_DSP
	select GD32_HAS_AFIO_PINMUX
	select GD32_HAS_IRC_40K
	select SOC_EARLY_INIT_HOOK
```

## soc/gd/gd32/gd32e51x/Kconfig.defconfig.series
```kconfig
# Copyright (c) 2026 GigaDevice Semiconductor Inc.
# SPDX-License-Identifier: Apache-2.0

if SOC_SERIES_GD32E51X

rsource "Kconfig.defconfig.gd32*"

endif # SOC_SERIES_GD32E51X
```

## soc/gd/gd32/gd32e51x/Kconfig.soc
```kconfig
# Copyright (c) 2025, GigaDevice Semiconductor Inc.
# SPDX-License-Identifier: Apache-2.0

config SOC_SERIES_GD32E51X
	bool
	select SOC_FAMILY_GD_GD32
	help
	  Enable support for GigaDevice GD32E51X MCU series

config SOC_SERIES
	default "gd32e51x" if SOC_SERIES_GD32E51X

config SOC_GD32E517
	bool
	select SOC_SERIES_GD32E51X

config SOC
	default "gd32e517" if SOC_GD32E517
```

## soc/gd/gd32/gd32f30x/Kconfig.soc
```kconfig
# Copyright (c) 2026, GigaDevice Semiconductor Inc.
# SPDX-License-Identifier: Apache-2.0

config SOC_SERIES_GD32F30X
	bool
	select SOC_FAMILY_GD_GD32
	help
	  Enable support for GigaDevice GD32F30x MCU series

config SOC_SERIES
	default "gd32f30x" if SOC_SERIES_GD32F30X

config SOC_GD32F307
	bool
	select SOC_SERIES_GD32F30X

config SOC
	default "gd32f307" if SOC_GD32F307
```

## soc/gd/gd32/gd32f50x/Kconfig
```kconfig
# Copyright (c) 2025 GigaDevice Semiconductor Inc.
# SPDX-License-Identifier: Apache-2.0

config SOC_SERIES_GD32F50X
	bool
	select ARM
	select CPU_HAS_ARM_MPU
	select CPU_HAS_FPU
	select CPU_CORTEX_M33
	select ARMV8_M_DSP
	select GD32_HAS_AF_PINMUX
	select GD32_HAS_IRC_40K
	select SOC_EARLY_INIT_HOOK
	help
	  Enable support for GigaDevice GD32F50x MCU series
```

## soc/gd/gd32/gd32f50x/Kconfig.defconfig.series
```kconfig
# Copyright (c) 2025, GigaDevice Semiconductor Inc.
# SPDX-License-Identifier: Apache-2.0

if SOC_SERIES_GD32F50X

rsource "Kconfig.defconfig.gd32f503"

endif # SOC_SERIES_GD32F50X
```

## soc/gd/gd32/gd32f50x/Kconfig.soc
```kconfig
# Copyright (c) 2025 GigaDevice Semiconductor Inc.
# SPDX-License-Identifier: Apache-2.0

config SOC_SERIES_GD32F50X
	bool
	select SOC_FAMILY_GD_GD32
	help
	  Enable support for GigaDevice GD32F50X MCU series

config SOC_SERIES
	default "gd32f50x" if SOC_SERIES_GD32F50X

config SOC_GD32F503
	bool
	select SOC_SERIES_GD32F50X

config SOC
	default "gd32f503" if SOC_GD32F503
```

## soc/gd/gd32/gd32f527/Kconfig.defconfig.series
```kconfig
# Copyright (c) 2025, GigaDevice Semiconductor Inc.
# SPDX-License-Identifier: Apache-2.0

if SOC_SERIES_GD32F527
rsource "Kconfig.defconfig.gd32f527"
endif
```

## soc/gd/gd32/gd32g5x3/Kconfig.defconfig.series
```kconfig
# Copyright (c) 2026 GigaDevice Semiconductor Inc.
# SPDX-License-Identifier: Apache-2.0

if SOC_SERIES_GD32G5X3
rsource "Kconfig.defconfig.gd32g553"
endif
```

## soc/gd/gd32/gd32g5x3/Kconfig.soc
```kconfig
# Copyright (c) 2026 GigaDevice Semiconductor Inc.
# SPDX-License-Identifier: Apache-2.0

config SOC_SERIES_GD32G5X3
	bool
	select SOC_FAMILY_GD_GD32
	help
	  Enable support for GigaDevice GD32G5X3 MCU series

config SOC_SERIES
	default "gd32g5x3" if SOC_SERIES_GD32G5X3

config SOC_GD32G553
	bool
	select SOC_SERIES_GD32G5X3

config SOC
	default "gd32g553" if SOC_GD32G553
```

## soc/gd/gd32/gd32h73x_75x/Kconfig.defconfig.gd32h759
```kconfig
# Copyright (c) 2026 GigaDevice Semiconductor Inc.
# SPDX-License-Identifier: Apache-2.0

if SOC_GD32H759

config SYS_CLOCK_HW_CYCLES_PER_SEC
	default $(dt_node_int_prop_int,/cpus/cpu@0,clock-frequency)

config NUM_IRQS
	default 217

endif # SOC_GD32H759
```

## soc/gd/gd32/gd32h75e/Kconfig.defconfig.series
```kconfig
# Copyright (c) 2026 GigaDevice Semiconductor Inc.
# SPDX-License-Identifier: Apache-2.0

if SOC_SERIES_GD32H75E

rsource "Kconfig.defconfig.gd32h75e"

# system_gd32h75e.c:SystemInit() unconditionally calls nvic_vector_table_set()
# which is implemented in gd32h75e_misc.c, so MISC HAL must always be compiled.
config USE_GD32_MISC
	default y

config ROM_START_OFFSET
	default 0x400 if BOOTLOADER_MCUBOOT
	default 0x0   if !BOOTLOADER_MCUBOOT

config CACHE_MANAGEMENT
	default y if CPU_CORTEX_M7

endif # SOC_SERIES_GD32H75E
```

## soc/gd/gd32/gd32h75e/Kconfig.soc
```kconfig
# Copyright (c) 2026 GigaDevice Semiconductor Inc.
# SPDX-License-Identifier: Apache-2.0

config SOC_SERIES_GD32H75E
	bool
	select SOC_FAMILY_GD_GD32
	help
	  Enable support for GigaDevice GD32H75E MCU series

config SOC_SERIES
	default "gd32h75e" if SOC_SERIES_GD32H75E

config SOC_GD32H75E
	bool
	select SOC_SERIES_GD32H75E

config SOC
	default "gd32h75e" if SOC_GD32H75E
```

## soc/gd/gd32/gd32h7xx/Kconfig
```kconfig
# Copyright (c) 2026 GigaDevice Semiconductor Inc.
# SPDX-License-Identifier: Apache-2.0

config SOC_SERIES_GD32H7XX
	select ARM
	select CPU_HAS_ARM_MPU
	select CPU_HAS_FPU
	select CPU_CORTEX_M7
	select GD32_HAS_AF_PINMUX
	select GD32_HAS_IRC_32K
	select HAS_SWO
	select CPU_CORTEX_M_HAS_DWT
	select CPU_HAS_CUSTOM_FIXED_SOC_MPU_REGIONS
	select CPU_HAS_FPU_DOUBLE_PRECISION
	select CPU_HAS_ICACHE
	select CPU_HAS_DCACHE
	select SOC_RESET_HOOK
	select SOC_EARLY_INIT_HOOK
```

## soc/gd/gd32/gd32h7xx/Kconfig.defconfig.series
```kconfig
# Copyright (c) 2026 GigaDevice Semiconductor Inc.
# SPDX-License-Identifier: Apache-2.0

if SOC_SERIES_GD32H7XX

rsource "Kconfig.defconfig.gd32h759"

config ROM_START_OFFSET
	default 0x400 if BOOTLOADER_MCUBOOT
	default 0x0   if !BOOTLOADER_MCUBOOT

config CACHE_MANAGEMENT
	default y if CPU_CORTEX_M7

endif # SOC_SERIES_GD32H7XX
```

## soc/gd/gd32/gd32h7xx/Kconfig.soc
```kconfig
# Copyright (c) 2026 GigaDevice Semiconductor Inc.
# SPDX-License-Identifier: Apache-2.0

config SOC_SERIES_GD32H7XX
	bool
	select SOC_FAMILY_GD_GD32
	help
	  Enable support for GigaDevice GD32H7XX MCU series

config SOC_SERIES
	default "gd32h7xx" if SOC_SERIES_GD32H7XX

config SOC_GD32H759
	bool
	select SOC_SERIES_GD32H7XX
config SOC
	default "gd32h759" if SOC_GD32H759
```

## soc/gd/gd32/gd32m53x/Kconfig
```kconfig
# Copyright (c) 2026 GigaDevice Semiconductor Inc.
# SPDX-License-Identifier: Apache-2.0

config SOC_SERIES_GD32M53X
	select ARM
	select CPU_HAS_ARM_MPU
	select CPU_HAS_FPU
	select ARMV8_M_DSP
	select CPU_CORTEX_M33
	select CPU_CORTEX_M_HAS_SYSTICK
	select CPU_CORTEX_M_HAS_DWT
	select GD32_HAS_AF_PINMUX
	select GD32_HAS_IRC_32K
	select HAS_GD32_HAL
	select SOC_RESET_HOOK
	select SOC_EARLY_INIT_HOOK
```

## soc/gd/gd32/gd32m53x/Kconfig.soc
```kconfig
# Copyright (c) 2026 GigaDevice Semiconductor Inc.
# SPDX-License-Identifier: Apache-2.0

config SOC_SERIES_GD32M53X
	bool
	select SOC_FAMILY_GD_GD32
	help
	  Enable support for GigaDevice GD32M53X MCU series

config SOC_SERIES
	default "gd32m53x" if SOC_SERIES_GD32M53X

config SOC_GD32M531
	bool
	select SOC_SERIES_GD32M53X

config SOC
	default "gd32m531" if SOC_GD32M531
```

## soc/gd/gd32/gd32w51x_f5hc/Kconfig.defconfig.series
```kconfig
# Copyright (c) 2026 GigaDevice Semiconductor Inc.
# SPDX-License-Identifier: Apache-2.0

if SOC_SERIES_GD32W51X_F5HC
rsource "Kconfig.defconfig.gd32w51x_f5hc"
endif
```

## soc/gd/gd32/gd32w51x_f5hc/Kconfig.soc
```kconfig
# Copyright (c) 2026 GigaDevice Semiconductor Inc.
# SPDX-License-Identifier: Apache-2.0

config SOC_SERIES_GD32W51X_F5HC
	bool
	select SOC_FAMILY_GD_GD32
	help
	  Enable support for GigaDevice GD32W51x/F5HC MCU series

config SOC_SERIES
	default "gd32w51x_f5hc" if SOC_SERIES_GD32W51X_F5HC

config SOC_GD32W51X_F5HC
	bool
	select SOC_SERIES_GD32W51X_F5HC

config SOC
	default "gd32w51x_f5hc" if SOC_GD32W51X_F5HC
```

## tests/drivers/can/api/boards/gd32f503v_eval.conf
```kconfig
# SPDX-FileCopyrightText: Copyright The Zephyr Project Contributors
# SPDX-License-Identifier: Apache-2.0

# GD32F503's Cortex-M33 implements only 4 MPU regions (MPU_TYPE.DREGION = 4).
# That is not enough to map the per-thread stack plus the ztest/libc memory
# domain partitions required by Zephyr userspace, so enabling user mode for the
# ZTEST_USER cases exhausts the dynamic MPU region slots at boot
# ("no free partition slots available") and the first user-mode test faults
# with an MPU data access violation when touching can_dev.
#
# The CAN controller API is fully exercised in supervisor mode, so run the
# ZTEST_USER cases in supervisor mode on this board by not enabling userspace.

CONFIG_TEST_USERSPACE=n
CONFIG_CAN_RX_TIMESTAMP=n
CONFIG_PM_DEVICE=n
```

## tests/drivers/flash/common/boards/gd32e517z_eval.conf
```kconfig
# Copyright (c) 2026 GigaDevice Semiconductor Inc.
# SPDX-License-Identifier: Apache-2.0

CONFIG_SPI=y
CONFIG_SPI_NOR=y

# The GD32 SPI driver registers a deinit handler; reference it to avoid an
# unused-function build error (-Werror) when the SPI NOR device is released.
CONFIG_DEVICE_DEINIT_SUPPORT=y

# gd25q16 SPI NOR is 16 Mbit = 2 MB; enable flash_get_size verification so
# the get_size test runs (PASS) instead of being skipped.
CONFIG_TEST_DRIVER_FLASH_SIZE=2097152
```
