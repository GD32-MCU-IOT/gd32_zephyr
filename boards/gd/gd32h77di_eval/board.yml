## boards/gd/gd32h77di_eval/board.yml
```yaml
board:
  name: gd32h77di_eval
  full_name: GD32H77DI-EVAL
  vendor: gd
  socs:
    - name: gd32h77d
```

## boards/gd/gd32l235r_eval/board.yml
```yaml
board:
  name: gd32l235r_eval
  full_name: GD32L235R-EVAL
  vendor: gd
  socs:
    - name: gd32l235
```

## drivers/i2c/Kconfig.gd32
```kconfig
# Copyright (c) 2021 BrainCo Inc.
# Copyright (c) 2026 GigaDevice Semiconductor Inc.
# SPDX-License-Identifier: Apache-2.0

config I2C_GD32
	bool "GigaDevice GD32 I2C driver"
	default y
	depends on DT_HAS_GD_GD32_I2C_ENABLED || DT_HAS_GD_GD32_I2C_V2_ENABLED
	select PINCTRL
	select USE_GD32_I2C
	help
	  Enable I2C support on the GD32 SoCs

if I2C_GD32

config I2C_GD32_LEGACY
	def_bool DT_HAS_GD_GD32_I2C_ENABLED
	help
	  Driver for the legacy GD32 I2C IP (gd,gd32-i2c).

config I2C_GD32_V2
	def_bool DT_HAS_GD_GD32_I2C_V2_ENABLED
	help
	  Driver for the GD32 ADD I2C IP with TIMING register (gd,gd32-i2c-v2).

endif # I2C_GD32

config I2C_GD32_DMA
	bool "GD32 I2C DMA support"
	depends on I2C_GD32 && DMA
	help
	  Enable DMA support for GD32 I2C controllers.
	  This can significantly improve performance for large transfers
	  by offloading data movement from the CPU to the DMA controller.

if I2C_GD32_DMA

config I2C_GD32_DMA_THRESHOLD
	int "DMA transfer threshold (bytes)"
	default 8
	help
	  Minimum transfer size (in bytes) to use DMA instead of PIO mode.
	  Transfers smaller than this threshold will use PIO mode.
	  Note: valid values are from 1 to 255 (bytes). Default is 8.


config I2C_GD32_DMA_TIMEOUT
	int "DMA transfer timeout (ms)"
	default 500
	help
	  Timeout in milliseconds for DMA transfers. If a transfer does not
	  complete within this time, the driver falls back to PIO mode.
	  Note: valid values are from 100 to 10000 (milliseconds). Default is 500.


endif # I2C_GD32_DMA
```

## dts/bindings/display/gd,gd32-tli.yaml
```yaml
# Copyright (c) 2025 GigaDevice Semiconductor Inc.
# SPDX-License-Identifier: Apache-2.0

description: GD32 TLI (TFT-LCD Interface) display controller

compatible: "gd,gd32-tli"

include: [base.yaml, pinctrl-device.yaml]

properties:
  reg:
    required: true

  clocks:
    required: true

  disp-en-gpios:
    type: phandle-array
    description: |
      Display enable GPIO signal (optional).
      This signal is used to enable/disable the LCD panel.

  bl-ctrl-gpios:
    type: phandle-array
    description: |
      Backlight control GPIO signal (optional).
      This signal is used to control the LCD backlight on/off.

  hsync:
    type: int
    required: true
    description: Horizontal synchronization pulse width in pixels

  vsync:
    type: int
    required: true
    description: Vertical synchronization pulse width in lines

  hbp:
    type: int
    required: true
    description: Horizontal back porch in pixels

  vbp:
    type: int
    required: true
    description: Vertical back porch in lines

  hfp:
    type: int
    required: true
    description: Horizontal front porch in pixels

  vfp:
    type: int
    required: true
    description: Vertical front porch in lines

  width:
    type: int
    required: true
    description: Active display width in pixels

  height:
    type: int
    required: true
    description: Active display height in lines

  pllsai-n:
    type: int
    description: PLLSAI N multiplication factor (GD32F4xx/GD32F527 only)

  pllsai-r:
    type: int
    description: PLLSAI R division factor (GD32F4xx/GD32F527 only)

  pllsair-div:
    type: int
    description: |
      PLLSAI R clock divider for TLI clock (GD32F4xx/GD32F527 only)
      Valid values: 2, 4, 8, 16 (RCU_PLLSAIR_DIVx)

  pll2-psc:
    type: int
    description: |
      PLL2 input prescaler (GD32H73x/75x only). The PLL2 input clock is the
      PLL source clock divided by this value and must be within 1-16 MHz.

  pll2-n:
    type: int
    description: PLL2 N multiplication factor (GD32H73x/75x only)

  pll2-r:
    type: int
    description: PLL2 R division factor (GD32H73x/75x only)

  pll2r-div:
    type: int
    description: |
      PLL2 R clock divider for TLI clock (GD32H73x/75x only). Use one of the
      GD32_RCU_PLL2R_DIV2/4/8/16 constants from gd32h73x_75x-clocks.h, the
      value is the RCU_CFG1 PLL2RDIV field encoding, not the divide factor.

  pixel-format:
    type: int
    default: 0
    description: |
      Default pixel format for the display.
      Supported values (matching Zephyr display_pixel_format enum):
        0  - PIXEL_FORMAT_RGB_888 (not commonly used, default to RGB565)
        1  - PIXEL_FORMAT_MONO01
        2  - PIXEL_FORMAT_MONO10
        3  - PIXEL_FORMAT_ARGB_8888 (32-bit, 4 bytes per pixel)
        4  - PIXEL_FORMAT_RGB_888 (24-bit, 3 bytes per pixel)
        5  - PIXEL_FORMAT_RGB_565 (16-bit, 2 bytes per pixel) - Default
        6  - PIXEL_FORMAT_BGR_565 (16-bit, 2 bytes per pixel)
      The driver will use RGB565 if not specified.

      GD32 TLI hardware pixel formats (PPF[2:0]):
        000 - ARGB8888  (4 bytes/pixel)
        001 - RGB888    (3 bytes/pixel)
        010 - RGB565    (2 bytes/pixel)
        011 - ARGB1555  (2 bytes/pixel)
        100 - ARGB4444  (2 bytes/pixel)
        101 - L8        (1 byte/pixel)
        110 - AL44      (1 byte/pixel)
        111 - AL88      (2 bytes/pixel)
```

## dts/bindings/flash_controller/gd,gd32g553-flash-controller.yaml
```yaml
# Copyright (c) 2026 GigaDevice Semiconductor Inc.
# SPDX-License-Identifier: Apache-2.0

description: |
  GD32G5x3 flash controller.

  The main flash starts at 0x08000000 and holds Bank0 and Bank1 (up to
  2 x 256KB). Pages are 1KB in dual-bank mode (factory default) and 2KB
  in single-bank mode. The flash is programmed in 64-bit double-words.

  The main flash is a "gd,gd32-nv-flash" child node that also carries
  "soc-nv-flash" and must use write-block-size = <8>.

compatible: "gd,gd32g553-flash-controller"

include: flash-controller.yaml
```

## dts/bindings/flash_controller/gd,gd32h77x-78x-flash-controller.yaml
```yaml
# Copyright (c) 2026 GigaDevice Semiconductor Inc.
# SPDX-License-Identifier: Apache-2.0

description: |
  GD32H77x/78x non-volatile memory controller (NVMC).

  The code NVM (CNVM) starts at 0x08000000. It is erased by 64KB sector
  and programmed in 256-bit words. It is a "gd,gd32-nv-flash" child node
  that also carries "soc-nv-flash".

  The extended code NVM (ECNVM), when present, starts at the fixed address
  0x08200000. It is erased by 4KB page and programmed in 256-bit words by
  this driver. It is a "gd,gd32-nv-flash" child node without
  "soc-nv-flash", and the driver exposes it as its own flash device.

  Both child nodes must use write-block-size = <32>.

compatible: "gd,gd32h77x-78x-flash-controller"

include: gd,gd32-flash-controller.yaml
```

## dts/bindings/i2c/gd,gd32-i2c-v2.yaml
```yaml
# Copyright (c) 2026 GigaDevice Semiconductor Inc.
# SPDX-License-Identifier: Apache-2.0

description: |
  GigaDevice GD32 I2C, ADD IP variant (TIMING/STAT/STATC/RDATA/TDATA registers).
  The legacy GD32 I2C IP (STAT0/STAT1/CKCFG registers) uses "gd,gd32-i2c".

compatible: "gd,gd32-i2c-v2"

include: [i2c-controller.yaml, reset-device.yaml, pinctrl-device.yaml]

properties:
  reg:
    required: true

  interrupts:
    required: true

  resets:
    required: true

  clocks:
    required: true

  pinctrl-0:
    required: true

  pinctrl-names:
    required: true
```

## soc/gd/gd32/gd32h77x_78x/Kconfig.defconfig.series
```kconfig
# Copyright (c) 2026 GigaDevice Semiconductor Inc.
# SPDX-License-Identifier: Apache-2.0

if SOC_SERIES_GD32H77X_78X

rsource "Kconfig.defconfig.gd32h77d"

config ROM_START_OFFSET
	default 0x400 if BOOTLOADER_MCUBOOT
	default 0x0   if !BOOTLOADER_MCUBOOT

config CACHE_MANAGEMENT
	default y if CPU_CORTEX_M7

config CAN_GD32_CAN_V2_FD
	default y

endif # SOC_SERIES_GD32H77X_78X
```

## soc/gd/gd32/gd32h77x_78x/Kconfig.soc
```kconfig
# Copyright (c) 2026 GigaDevice Semiconductor Inc.
# SPDX-License-Identifier: Apache-2.0

config SOC_SERIES_GD32H77X_78X
	bool
	select SOC_FAMILY_GD_GD32
	help
	  Enable support for GigaDevice GD32H77x/GD32H78x MCU series

config SOC_SERIES
	default "gd32h77x_78x" if SOC_SERIES_GD32H77X_78X

config SOC_GD32H77D
	bool
	select SOC_SERIES_GD32H77X_78X

config SOC
	default "gd32h77d" if SOC_GD32H77D
```

## tests/drivers/spi/spi_loopback/boards/gd32l235r_eval.conf
```kconfig
CONFIG_GPIO=y
CONFIG_SPI_LARGE_BUFFER_SIZE=256
CONFIG_MAIN_STACK_SIZE=512
CONFIG_SYSTEM_WORKQUEUE_STACK_SIZE=512
CONFIG_ISR_STACK_SIZE=1024
CONFIG_IDLE_STACK_SIZE=128
CONFIG_ZTEST_STACK_SIZE=512
CONFIG_SPI_LOOPBACK_MODE_LOOP=y
```
