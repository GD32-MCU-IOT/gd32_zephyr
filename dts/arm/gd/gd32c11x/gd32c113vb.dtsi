/*
 * Copyright (c) 2026, GigaDevice Semiconductor Inc.
 *
 * SPDX-License-Identifier: Apache-2.0
 */

#include <mem.h>
#include <gd/gd32c11x/gd32c11x.dtsi>

&flash0 {
	reg = <0x08000000 DT_SIZE_K(128)>;
};

&sram0 {
	reg = <0x20000000 DT_SIZE_K(32)>;
};
