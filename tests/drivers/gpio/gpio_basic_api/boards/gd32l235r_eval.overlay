/*
 * Copyright (c) 2026 GigaDevice Semiconductor Inc.
 * SPDX-License-Identifier: Apache-2.0
 */

/ {
	resources {
		compatible = "test-gpio-basic-api";
		/* Connect PB14 (output) and PB15 (input) with a jumper. */
		out-gpios = <&gpiob 14 GPIO_PULL_UP>;
		in-gpios = <&gpiob 15 GPIO_PULL_UP>;
	};
};
